/dts-v1/;

/ {
	model = "MT6761";
	compatible = "mediatek,MT6761";
	interrupt-parent = <0x01>;
	#address-cells = <0x02>;
	#size-cells = <0x02>;

	chosen {
		bootargs = "console=tty0 console=ttyS0,921600n1 vmalloc=496M slub_max_order=0 slub_debug=OFZPU page_owner=on androidboot.hardware=mt6761 maxcpus=8 firmware_class.path=/vendor/firmware loop.max_part=7";
		linux,phandle = <0x45>;
		phandle = <0x45>;
	};

	cpus {
		#address-cells = <0x01>;
		#size-cells = <0x00>;

		cpu@000 {
			device_type = "cpu";
			compatible = "arm,cortex-a53";
			reg = <0x00>;
			enable-method = "psci";
			clock-frequency = <0x8b799100>;
			cpu-idle-states = <0x02 0x03 0x04 0x05 0x06 0x07 0x08>;
			linux,phandle = <0x09>;
			phandle = <0x09>;
		};

		cpu@001 {
			device_type = "cpu";
			compatible = "arm,cortex-a53";
			reg = <0x01>;
			enable-method = "psci";
			clock-frequency = <0x8b799100>;
			cpu-idle-states = <0x02 0x03 0x04 0x05 0x06 0x07 0x08>;
			linux,phandle = <0x0a>;
			phandle = <0x0a>;
		};

		cpu@002 {
			device_type = "cpu";
			compatible = "arm,cortex-a53";
			reg = <0x02>;
			enable-method = "psci";
			clock-frequency = <0x8b799100>;
			cpu-idle-states = <0x02 0x03 0x04 0x05 0x06 0x07 0x08>;
			linux,phandle = <0x0b>;
			phandle = <0x0b>;
		};

		cpu@003 {
			device_type = "cpu";
			compatible = "arm,cortex-a53";
			reg = <0x03>;
			enable-method = "psci";
			clock-frequency = <0x8b799100>;
			cpu-idle-states = <0x02 0x03 0x04 0x05 0x06 0x07 0x08>;
			linux,phandle = <0x0c>;
			phandle = <0x0c>;
		};

		cpu-map {

			cluster0 {

				core0 {
					cpu = <0x09>;
				};

				core1 {
					cpu = <0x0a>;
				};

				core2 {
					cpu = <0x0b>;
				};

				core3 {
					cpu = <0x0c>;
				};
			};
		};

		idle-states {
			entry-method = "arm,psci";

			standby {
				compatible = "arm,idle-state";
				arm,psci-suspend-param = <0x01>;
				entry-latency-us = <0x258>;
				exit-latency-us = <0x258>;
				min-residency-us = <0x4b0>;
				linux,phandle = <0x02>;
				phandle = <0x02>;
			};

			mcdi-cpu {
				compatible = "arm,idle-state";
				arm,psci-suspend-param = <0x10001>;
				entry-latency-us = <0x258>;
				exit-latency-us = <0x258>;
				min-residency-us = <0x4b0>;
				linux,phandle = <0x03>;
				phandle = <0x03>;
			};

			mcdi-cluster {
				compatible = "arm,idle-state";
				arm,psci-suspend-param = <0x1010001>;
				entry-latency-us = <0x258>;
				exit-latency-us = <0x258>;
				min-residency-us = <0x4b0>;
				linux,phandle = <0x04>;
				phandle = <0x04>;
			};

			sodi {
				compatible = "arm,idle-state";
				arm,psci-suspend-param = <0x1010002>;
				entry-latency-us = <0x320>;
				exit-latency-us = <0x3e8>;
				min-residency-us = <0x7d0>;
				linux,phandle = <0x05>;
				phandle = <0x05>;
			};

			sodi3 {
				compatible = "arm,idle-state";
				arm,psci-suspend-param = <0x1010003>;
				entry-latency-us = <0x320>;
				exit-latency-us = <0x3e8>;
				min-residency-us = <0x7d0>;
				linux,phandle = <0x06>;
				phandle = <0x06>;
			};

			dpidle {
				compatible = "arm,idle-state";
				arm,psci-suspend-param = <0x1010004>;
				entry-latency-us = <0x320>;
				exit-latency-us = <0x3e8>;
				min-residency-us = <0x7d0>;
				linux,phandle = <0x07>;
				phandle = <0x07>;
			};

			suspend {
				compatible = "arm,idle-state";
				arm,psci-suspend-param = <0x1010005>;
				entry-latency-us = <0x320>;
				exit-latency-us = <0x3e8>;
				min-residency-us = <0x7d0>;
				linux,phandle = <0x08>;
				phandle = <0x08>;
			};
		};
	};

	psci {
		compatible = "arm,psci-1.0";
		method = "smc";
	};

	pmu {
		compatible = "arm,cortex-a7-pmu";
		interrupt-parent = <0x0d>;
		interrupts = <0x01 0x07 0x08>;
	};

	l2c_parity {
		compatible = "mediatek,l2c_parity-v1";
		interrupts = <0x00 0x00 0x04>;
	};

	memory {
		device_type = "memory";
		reg = <0x00 0x40000000 0x00 0x20000000>;
	};

	reserved-memory {
		#address-cells = <0x02>;
		#size-cells = <0x02>;
		ranges;

		ram_console-reserved-memory@47c80000 {
			compatible = "mediatek,ram_console";
			reg = <0x00 0x47c80000 0x00 0x10000>;
		};

		pstore-reserved-memory@47c90000 {
			compatible = "mediatek,pstore";
			reg = <0x00 0x47c90000 0x00 0xe0000>;
		};

		minirdump-reserved-memory@47d70000 {
			compatible = "mediatek,minirdump";
			reg = <0x00 0x47d70000 0x00 0x10000>;
		};

		reserve-memory-sspm_share {
			compatible = "mediatek,reserve-memory-sspm_share";
			no-map;
			status = "okay";
			size = <0x00 0x110000>;
			alignment = <0x00 0x10000>;
			alloc-ranges = <0x00 0x40000000 0x00 0x60000000>;
		};

		reserve-memory-scp_share {
			compatible = "mediatek,reserve-memory-scp_share";
			no-map;
			size = <0x00 0x300000>;
			alignment = <0x00 0x1000000>;
			alloc-ranges = <0x00 0x40000000 0x00 0x50000000>;
		};

		consys-reserve-memory {
			compatible = "mediatek,consys-reserve-memory";
			no-map;
			size = <0x00 0x400000>;
			alignment = <0x00 0x1000000>;
			alloc-ranges = <0x00 0x40000000 0x00 0x80000000>;
		};

		wifi-reserve-memory {
			compatible = "mediatek,wifi-reserve-memory";
			no-map;
			size = <0x00 0x300000>;
			alignment = <0x00 0x1000000>;
			alloc-ranges = <0x00 0x40000000 0x00 0x80000000>;
		};

		soter-shared-mem {
			compatible = "microtrust,shared_mem";
			no-map;
			size = <0x00 0x200000>;
			alloc-ranges = <0x00 0x40000000 0x00 0x50000000>;
		};
	};

	utos {
		compatible = "microtrust,utos";
		interrupts = <0x00 0xbc 0x01 0x00 0xbd 0x01>;
	};

	utos_tester {
		compatible = "microtrust,tester-v1";
	};

	cpu_dbgapb@0d410000 {
		compatible = "mediatek,hw_dbg";
		num = <0x08>;
		reg = <0x00 0xd410000 0x00 0x1000 0x00 0xd510000 0x00 0x1000 0x00 0xd610000 0x00 0x1000 0x00 0xd710000 0x00 0x1000 0x00 0xd810000 0x00 0x1000 0x00 0xd910000 0x00 0x1000 0x00 0xda10000 0x00 0x1000 0x00 0xdb10000 0x00 0x1000>;
		linux,phandle = <0x46>;
		phandle = <0x46>;
	};

	atf_logger {
		compatible = "mediatek,atf_logger";
		interrupts = <0x00 0x4e 0x01>;
	};

	amms_control {
		compatible = "mediatek,amms";
		interrupts = <0x00 0x43 0x01>;
	};

	interrupt-controller@0c000000 {
		compatible = "arm,gic-v3";
		#interrupt-cells = <0x03>;
		#address-cells = <0x02>;
		#size-cells = <0x02>;
		#redistributor-regions = <0x01>;
		interrupt-parent = <0x0d>;
		interrupt-controller;
		reg = <0x00 0xc000000 0x00 0x40000 0x00 0xc080000 0x00 0x200000 0x00 0x10200a80 0x00 0x50>;
		interrupts = <0x01 0x09 0x04>;
		linux,phandle = <0x0d>;
		phandle = <0x0d>;
	};

	intpol-controller@10200a80 {
		compatible = "mediatek,mt6577-sysirq";
		interrupt-controller;
		#interrupt-cells = <0x03>;
		interrupt-parent = <0x0d>;
		reg = <0x00 0x10200a80 0x00 0x50>;
		linux,phandle = <0x01>;
		phandle = <0x01>;
	};

	infracfg_ao@10001000 {
		compatible = "mediatek,infracfg_ao\0syscon";
		reg = <0x00 0x10001000 0x00 0x1000>;
		interrupts = <0x00 0x5b 0x01>;
		#clock-cells = <0x01>;
		linux,phandle = <0x1f>;
		phandle = <0x1f>;
	};

	mcdi@0010fc00 {
		compatible = "mediatek,mt6761-mcdi";
		reg = <0x00 0x10fc00 0x00 0x800>;
	};

	scpsys@10001000 {
		compatible = "mediatek,scpsys\0syscon";
		reg = <0x00 0x10001000 0x00 0x1000 0x00 0x10006000 0x00 0x1000 0x00 0x14002000 0x00 0x1000 0x00 0x1020e000 0x00 0x1000 0x00 0x18004000 0x00 0x1000>;
		#clock-cells = <0x01>;
		linux,phandle = <0x20>;
		phandle = <0x20>;
	};

	topckgen@10000000 {
		compatible = "mediatek,topckgen\0syscon";
		reg = <0x00 0x10000000 0x00 0x1000>;
		#clock-cells = <0x01>;
		linux,phandle = <0x19>;
		phandle = <0x19>;
	};

	io_cfg_lt@10002000 {
		compatible = "mediatek,io_cfg_lt";
		reg = <0x00 0x10002000 0x00 0x200>;
	};

	syscfg_pctl_1@10002000 {
		compatible = "mediatek,mt6761-pctl-1-syscfg\0syscon";
		reg = <0x00 0x10002000 0x00 0x1000>;
		linux,phandle = <0x12>;
		phandle = <0x12>;
	};

	io_cfg_lm@10002200 {
		compatible = "mediatek,io_cfg_lm";
		reg = <0x00 0x10002200 0x00 0x200>;
	};

	syscfg_pctl_2@10002200 {
		compatible = "mediatek,mt6761-pctl-2-syscfg\0syscon";
		reg = <0x00 0x10002200 0x00 0x1000>;
		linux,phandle = <0x13>;
		phandle = <0x13>;
	};

	io_cfg_lb@10002400 {
		compatible = "mediatek,io_cfg_lb";
		reg = <0x00 0x10002400 0x00 0x200>;
	};

	syscfg_pctl_3@10002400 {
		compatible = "mediatek,mt6761-pctl-3-syscfg\0syscon";
		reg = <0x00 0x10002400 0x00 0x1000>;
		linux,phandle = <0x14>;
		phandle = <0x14>;
	};

	io_cfg_bl@10002600 {
		compatible = "mediatek,io_cfg_bl";
		reg = <0x00 0x10002600 0x00 0x200>;
	};

	syscfg_pctl_4@10002600 {
		compatible = "mediatek,mt6761-pctl-4-syscfg\0syscon";
		reg = <0x00 0x10002600 0x00 0x1000>;
		linux,phandle = <0x15>;
		phandle = <0x15>;
	};

	io_cfg_rr@10002800 {
		compatible = "mediatek,io_cfg_rr";
		reg = <0x00 0x10002800 0x00 0x200>;
	};

	syscfg_pctl_5@10002800 {
		compatible = "mediatek,mt6761-pctl-5-syscfg\0syscon";
		reg = <0x00 0x10002800 0x00 0x1000>;
		linux,phandle = <0x16>;
		phandle = <0x16>;
	};

	io_cfg_rb@10002a00 {
		compatible = "mediatek,io_cfg_rb";
		reg = <0x00 0x10002a00 0x00 0x200>;
	};

	syscfg_pctl_6@10002a00 {
		compatible = "mediatek,mt6761-pctl-6-syscfg\0syscon";
		reg = <0x00 0x10002a00 0x00 0x1000>;
		linux,phandle = <0x17>;
		phandle = <0x17>;
	};

	io_cfg_rt@10002c00 {
		compatible = "mediatek,io_cfg_rt";
		reg = <0x00 0x10002c00 0x00 0x200>;
	};

	syscfg_pctl_7@10002c00 {
		compatible = "mediatek,mt6761-pctl-7-syscfg\0syscon";
		reg = <0x00 0x10002c00 0x00 0x1000>;
		linux,phandle = <0x18>;
		phandle = <0x18>;
	};

	pericfg@10003000 {
		compatible = "mediatek,pericfg\0syscon";
		reg = <0x00 0x10003000 0x00 0x1000>;
		#clock-cells = <0x01>;
		linux,phandle = <0x47>;
		phandle = <0x47>;
	};

	efuse_dbg@10004000 {
		compatible = "mediatek,efuse_dbg";
		reg = <0x00 0x10004000 0x00 0x1000>;
	};

	smart_pa {
		linux,phandle = <0x48>;
		phandle = <0x48>;
	};

	tcpc_pd {
		linux,phandle = <0x49>;
		phandle = <0x49>;
	};

	md1_sim1_hot_plug_eint {
		linux,phandle = <0x4a>;
		phandle = <0x4a>;
	};

	md1_sim2_hot_plug_eint {
		linux,phandle = <0x4b>;
		phandle = <0x4b>;
	};

	gpio {
		compatible = "mediatek,gpio_usage_mapping";
		linux,phandle = <0x4c>;
		phandle = <0x4c>;
	};

	gpio@10005000 {
		compatible = "mediatek,gpio";
		reg = <0x00 0x10005000 0x00 0x1000>;
		linux,phandle = <0x4d>;
		phandle = <0x4d>;
	};

	syscfg_pctl_0@10005000 {
		compatible = "mediatek,mt6761-pctl-0-syscfg\0syscon";
		reg = <0x00 0x10005000 0x00 0x1000>;
		linux,phandle = <0x11>;
		phandle = <0x11>;
	};

	sleep@10006000 {
		compatible = "mediatek,sleep";
		reg = <0x00 0x10006000 0x00 0x1000>;
		interrupts = <0x00 0x7d 0x08>;
		wakeup-source = <0x0e 0x00 0x04 0x0f 0x01 0x20 0x10 0x03 0x2000000>;
	};

	pinctrl@1000b000 {
		compatible = "mediatek,mt6761-pinctrl";
		reg = <0x00 0x1000b000 0x00 0x1000>;
		mediatek,pctl-regmap = <0x11 0x12 0x13 0x14 0x15 0x16 0x17 0x18>;
		pins-are-numbered;
		gpio-controller;
		#gpio-cells = <0x02>;
		interrupt-controller;
		#interrupt-cells = <0x04>;
		interrupts = <0x00 0x73 0x04>;
		linux,phandle = <0x37>;
		phandle = <0x37>;

		msdc0@default {
			linux,phandle = <0x2d>;
			phandle = <0x2d>;

			pins_cmd {
				drive-strength = [03];
			};

			pins_dat {
				drive-strength = [03];
			};

			pins_clk {
				drive-strength = [03];
			};

			pins_rst {
				drive-strength = [03];
			};

			pins_ds {
				drive-strength = [03];
			};
		};

		msdc0@hs400 {
			linux,phandle = <0x2e>;
			phandle = <0x2e>;

			pins_cmd {
				drive-strength = [03];
			};

			pins_dat {
				drive-strength = [04];
			};

			pins_clk {
				drive-strength = [04];
			};

			pins_rst {
				drive-strength = [03];
			};

			pins_ds {
				drive-strength = [04];
			};
		};

		msdc0@hs200 {
			linux,phandle = <0x2f>;
			phandle = <0x2f>;

			pins_cmd {
				drive-strength = [03];
			};

			pins_dat {
				drive-strength = [04];
			};

			pins_clk {
				drive-strength = [04];
			};

			pins_rst {
				drive-strength = [03];
			};

			pins_ds {
				drive-strength = [04];
			};
		};

		msdc0@register_default {
			cmd_edge = [00];
			rdata_edge = [00];
			wdata_edge = [00];
			linux,phandle = <0x30>;
			phandle = <0x30>;
		};

		msdc1@default {
			linux,phandle = <0x32>;
			phandle = <0x32>;

			pins_cmd {
				drive-strength = [03];
			};

			pins_dat {
				drive-strength = [03];
			};

			pins_clk {
				drive-strength = [03];
			};
		};

		msdc1@sdr104 {
			linux,phandle = <0x33>;
			phandle = <0x33>;

			pins_cmd {
				drive-strength = [03];
			};

			pins_dat {
				drive-strength = [03];
			};

			pins_clk {
				drive-strength = [03];
			};
		};

		msdc1@sdr50 {
			linux,phandle = <0x34>;
			phandle = <0x34>;

			pins_cmd {
				drive-strength = [03];
			};

			pins_dat {
				drive-strength = [03];
			};

			pins_clk {
				drive-strength = [03];
			};
		};

		msdc1@ddr50 {
			linux,phandle = <0x35>;
			phandle = <0x35>;

			pins_cmd {
				drive-strength = [03];
			};

			pins_dat {
				drive-strength = [03];
			};

			pins_clk {
				drive-strength = [03];
			};
		};

		msdc1@register_default {
			cmd_edge = [00];
			rdata_edge = [00];
			wdata_edge = [00];
			linux,phandle = <0x36>;
			phandle = <0x36>;
		};

		msdc3@default {
			linux,phandle = <0x4e>;
			phandle = <0x4e>;

			pins_cmd {
				drive-strength = [04];
			};

			pins_dat {
				drive-strength = [04];
			};

			pins_clk {
				drive-strength = [04];
			};
		};

		msdc3@register_default {
			cmd_edge = [01];
			rdata_edge = [01];
			wdata_edge = [01];
			linux,phandle = <0x4f>;
			phandle = <0x4f>;
		};
	};

	toprgu@10007000 {
		compatible = "mediatek,toprgu";
		reg = <0x00 0x10007000 0x00 0x1000>;
		interrupts = <0x00 0x53 0x00>;
	};

	chipid@08000000 {
		compatible = "mediatek,chipid";
		reg = <0x00 0x8000000 0x00 0x04 0x00 0x8000004 0x00 0x04 0x00 0x8000008 0x00 0x04 0x00 0x800000c 0x00 0x04>;
	};

	mobicore {
		compatible = "trustonic,mobicore";
		interrupts = <0x00 0xc2 0x01>;
	};

	tkcore {
		compatible = "trustkernel,tkcore";
		interrupts = <0x00 0xc4 0x01>;
	};

	timer {
		compatible = "arm,armv8-timer";
		interrupt-parent = <0x0d>;
		interrupts = <0x01 0x0d 0x08 0x01 0x0e 0x08 0x01 0x0b 0x08 0x01 0x0a 0x08>;
		clock-frequency = <0xc65d40>;
	};

	clocks {

		clk26m {
			compatible = "fixed-clock";
			#clock-cells = <0x00>;
			clock-frequency = <0x18cba80>;
			linux,phandle = <0x1b>;
			phandle = <0x1b>;
		};

		clk32k {
			compatible = "fixed-clock";
			#clock-cells = <0x00>;
			clock-frequency = <0x7d00>;
			linux,phandle = <0x1a>;
			phandle = <0x1a>;
		};
	};

	timer@10008000 {
		compatible = "mediatek,apxgpt";
		reg = <0x00 0x10008000 0x00 0x1000>;
		interrupts = <0x00 0x72 0x08>;
		clocks = <0x19 0x87 0x1a>;
		clock-names = "clk13m\0clk32k";
		linux,phandle = <0x50>;
		phandle = <0x50>;
	};

	hacc@1000a000 {
		compatible = "mediatek,hacc";
		reg = <0x00 0x1000a000 0x00 0x1000>;
		interrupts = <0x00 0x85 0x08>;
	};

	apirq@1000b000 {
		compatible = "mediatek,apirq";
		reg = <0x00 0x1000b000 0x00 0x1000>;
		interrupts = <0x00 0x73 0x04>;
	};

	apmixed@1000c000 {
		compatible = "mediatek,apmixed\0syscon";
		reg = <0x00 0x1000c000 0x00 0x1000>;
		#clock-cells = <0x01>;
		linux,phandle = <0x3b>;
		phandle = <0x3b>;
	};

	fhctl@1000ce00 {
		compatible = "mediatek,fhctl";
		reg = <0x00 0x1000ce00 0x00 0x200>;
	};

	pwrap@1000d000 {
		compatible = "mediatek,pwrap";
		reg = <0x00 0x1000d000 0x00 0x1000>;
		interrupts = <0x00 0x7b 0x04>;
	};

	mt-pmic {
		compatible = "mediatek,mt_pmic";
		interrupt-controller;
		linux,phandle = <0x51>;
		phandle = <0x51>;

		mt635x-auxadc {
			compatible = "mediatek,mt635x-auxadc";
			#io-channel-cells = <0x01>;
			linux,phandle = <0x52>;
			phandle = <0x52>;

			batadc {
				channel = <0x00>;
				resistance-ratio = <0x03 0x01>;
				avg-num = <0x80>;
			};

			isense {
				channel = <0x01>;
				resistance-ratio = <0x03 0x01>;
				avg-num = <0x80>;
			};

			vcdt {
				channel = <0x02>;
			};

			bat_temp {
				channel = <0x03>;
				resistance-ratio = <0x01 0x01>;
			};

			chip_temp {
				channel = <0x05>;
			};

			vcore_temp {
				channel = <0x06>;
			};

			vproc_temp {
				channel = <0x07>;
			};

			accdet {
				channel = <0x09>;
			};

			tsx_temp {
				channel = <0x0b>;
				avg-num = <0x80>;
			};

			hpofs_cal {
				channel = <0x0c>;
				avg-num = <0x100>;
			};

			dcxo_temp {
				channel = <0x0d>;
				avg-num = <0x10>;
			};

			vbif {
				channel = <0x0e>;
				resistance-ratio = <0x01 0x01>;
			};
		};

		buck_regulators {

			buck_vs1 {
				regulator-name = "vs1";
				regulator-min-microvolt = <0x124f80>;
				regulator-max-microvolt = <0x2191c0>;
				regulator-ramp-delay = <0x30d4>;
				regulator-enable-ramp-delay = <0xdc>;
				linux,phandle = <0x53>;
				phandle = <0x53>;
			};

			buck_vmodem {
				regulator-name = "vmodem";
				regulator-min-microvolt = <0x7a120>;
				regulator-max-microvolt = <0x123716>;
				regulator-ramp-delay = <0x186a>;
				regulator-enable-ramp-delay = <0xdc>;
				linux,phandle = <0x54>;
				phandle = <0x54>;
			};

			buck_vcore {
				regulator-name = "vcore";
				regulator-min-microvolt = <0x7ea5e>;
				regulator-max-microvolt = <0x1406f4>;
				regulator-ramp-delay = <0x186a>;
				regulator-enable-ramp-delay = <0xdc>;
				linux,phandle = <0x55>;
				phandle = <0x55>;
			};

			buck_vproc {
				regulator-name = "vproc";
				regulator-min-microvolt = <0x7ea5e>;
				regulator-max-microvolt = <0x1406f4>;
				regulator-ramp-delay = <0x186a>;
				regulator-enable-ramp-delay = <0xdc>;
				linux,phandle = <0x56>;
				phandle = <0x56>;
			};

			buck_vpa {
				regulator-name = "vpa";
				regulator-min-microvolt = <0x7a120>;
				regulator-max-microvolt = <0x37b1d0>;
				regulator-ramp-delay = <0xc350>;
				regulator-enable-ramp-delay = <0xdc>;
				linux,phandle = <0x57>;
				phandle = <0x57>;
			};
		};

		ldo_regulators {

			ldo_vfe28 {
				compatible = "regulator-fixed";
				regulator-name = "vfe28";
				regulator-min-microvolt = <0x2ab980>;
				regulator-max-microvolt = <0x2ab980>;
				regulator-enable-ramp-delay = <0x108>;
				linux,phandle = <0x58>;
				phandle = <0x58>;
			};

			ldo_vxo22 {
				regulator-name = "vxo22";
				regulator-min-microvolt = <0x2191c0>;
				regulator-max-microvolt = <0x249f00>;
				regulator-enable-ramp-delay = <0x6e>;
				linux,phandle = <0x59>;
				phandle = <0x59>;
			};

			ldo_vrf18 {
				compatible = "regulator-fixed";
				regulator-name = "vrf18";
				regulator-min-microvolt = <0x1b7740>;
				regulator-max-microvolt = <0x1b7740>;
				regulator-enable-ramp-delay = <0x6e>;
				linux,phandle = <0x5a>;
				phandle = <0x5a>;
			};

			ldo_vrf12 {
				compatible = "regulator-fixed";
				regulator-name = "vrf12";
				regulator-min-microvolt = <0x124f80>;
				regulator-max-microvolt = <0x124f80>;
				regulator-enable-ramp-delay = <0x6e>;
				linux,phandle = <0x5b>;
				phandle = <0x5b>;
			};

			ldo_vefuse {
				regulator-name = "vefuse";
				regulator-min-microvolt = <0x124f80>;
				regulator-max-microvolt = <0x325aa0>;
				regulator-enable-ramp-delay = <0x108>;
				linux,phandle = <0x5c>;
				phandle = <0x5c>;
			};

			ldo_vcn33_bt {
				regulator-name = "vcn33_bt";
				regulator-min-microvolt = <0x325aa0>;
				regulator-max-microvolt = <0x3567e0>;
				regulator-enable-ramp-delay = <0x108>;
				linux,phandle = <0x5d>;
				phandle = <0x5d>;
			};

			ldo_vcn33_wifi {
				regulator-name = "vcn33_wifi";
				regulator-min-microvolt = <0x325aa0>;
				regulator-max-microvolt = <0x3567e0>;
				regulator-enable-ramp-delay = <0x108>;
				linux,phandle = <0x5e>;
				phandle = <0x5e>;
			};

			ldo_vcn28 {
				compatible = "regulator-fixed";
				regulator-name = "vcn28";
				regulator-min-microvolt = <0x2ab980>;
				regulator-max-microvolt = <0x2ab980>;
				regulator-enable-ramp-delay = <0x108>;
				linux,phandle = <0x5f>;
				phandle = <0x5f>;
			};

			ldo_vcn18 {
				compatible = "regulator-fixed";
				regulator-name = "vcn18";
				regulator-min-microvolt = <0x1b7740>;
				regulator-max-microvolt = <0x1b7740>;
				regulator-enable-ramp-delay = <0x108>;
				linux,phandle = <0x60>;
				phandle = <0x60>;
			};

			ldo_vcama {
				regulator-name = "vcama";
				regulator-min-microvolt = <0x2625a0>;
				regulator-max-microvolt = <0x2ab980>;
				regulator-enable-ramp-delay = <0x108>;
				linux,phandle = <0x61>;
				phandle = <0x61>;
			};

			ldo_vcamd {
				regulator-name = "vcamd";
				regulator-min-microvolt = <0xf4240>;
				regulator-max-microvolt = <0x1b7740>;
				regulator-enable-ramp-delay = <0x108>;
				linux,phandle = <0x62>;
				phandle = <0x62>;
			};

			ldo_vcamio {
				compatible = "regulator-fixed";
				regulator-name = "vcamio";
				regulator-min-microvolt = <0x1b7740>;
				regulator-max-microvolt = <0x1b7740>;
				regulator-enable-ramp-delay = <0x108>;
				linux,phandle = <0x63>;
				phandle = <0x63>;
			};

			ldo_vldo28 {
				regulator-name = "vldo28";
				regulator-min-microvolt = <0x2ab980>;
				regulator-max-microvolt = <0x2dc6c0>;
				regulator-enable-ramp-delay = <0x108>;
				linux,phandle = <0x64>;
				phandle = <0x64>;
			};

			ldo_vsram_others {
				regulator-name = "vsram_others";
				regulator-min-microvolt = <0x7ea5e>;
				regulator-max-microvolt = <0x1406f4>;
				regulator-ramp-delay = <0x186a>;
				regulator-enable-ramp-delay = <0x6e>;
				linux,phandle = <0x65>;
				phandle = <0x65>;
			};

			ldo_vsram_proc {
				regulator-name = "vsram_proc";
				regulator-min-microvolt = <0x7ea5e>;
				regulator-max-microvolt = <0x1406f4>;
				regulator-ramp-delay = <0x186a>;
				regulator-enable-ramp-delay = <0x6e>;
				linux,phandle = <0x66>;
				phandle = <0x66>;
			};

			ldo_vaux18 {
				compatible = "regulator-fixed";
				regulator-name = "vaux18";
				regulator-min-microvolt = <0x1b7740>;
				regulator-max-microvolt = <0x1b7740>;
				regulator-enable-ramp-delay = <0x108>;
				linux,phandle = <0x67>;
				phandle = <0x67>;
			};

			ldo_vaud28 {
				compatible = "regulator-fixed";
				regulator-name = "vaud28";
				regulator-min-microvolt = <0x2ab980>;
				regulator-max-microvolt = <0x2ab980>;
				regulator-enable-ramp-delay = <0x108>;
				linux,phandle = <0x68>;
				phandle = <0x68>;
			};

			ldo_vio28 {
				compatible = "regulator-fixed";
				regulator-name = "vio28";
				regulator-min-microvolt = <0x2ab980>;
				regulator-max-microvolt = <0x2ab980>;
				regulator-enable-ramp-delay = <0x108>;
				linux,phandle = <0x69>;
				phandle = <0x69>;
			};

			ldo_vio18 {
				compatible = "regulator-fixed";
				regulator-name = "vio18";
				regulator-min-microvolt = <0x1b7740>;
				regulator-max-microvolt = <0x1b7740>;
				regulator-enable-ramp-delay = <0x108>;
				linux,phandle = <0x6a>;
				phandle = <0x6a>;
			};

			ldo_vdram {
				regulator-name = "vdram";
				regulator-min-microvolt = <0x10c8e0>;
				regulator-max-microvolt = <0x124f80>;
				regulator-enable-ramp-delay = <0xce4>;
				linux,phandle = <0x6b>;
				phandle = <0x6b>;
			};

			ldo_vmc {
				regulator-name = "vmc";
				regulator-min-microvolt = <0x1b7740>;
				regulator-max-microvolt = <0x325aa0>;
				regulator-enable-ramp-delay = <0x2c>;
				linux,phandle = <0x39>;
				phandle = <0x39>;
			};

			ldo_vmch {
				regulator-name = "vmch";
				regulator-min-microvolt = <0x2c4020>;
				regulator-max-microvolt = <0x325aa0>;
				regulator-enable-ramp-delay = <0x2c>;
				linux,phandle = <0x38>;
				phandle = <0x38>;
			};

			ldo_vemc {
				regulator-name = "vemc";
				regulator-min-microvolt = <0x2c4020>;
				regulator-max-microvolt = <0x325aa0>;
				regulator-enable-ramp-delay = <0x2c>;
				linux,phandle = <0x31>;
				phandle = <0x31>;
			};

			ldo_vsim1 {
				regulator-name = "vsim1";
				regulator-min-microvolt = <0x19f0a0>;
				regulator-max-microvolt = <0x2f4d60>;
				regulator-enable-ramp-delay = <0x108>;
				linux,phandle = <0x6c>;
				phandle = <0x6c>;
			};

			ldo_vsim2 {
				regulator-name = "vsim2";
				regulator-min-microvolt = <0x19f0a0>;
				regulator-max-microvolt = <0x2f4d60>;
				regulator-enable-ramp-delay = <0x108>;
				linux,phandle = <0x6d>;
				phandle = <0x6d>;
			};

			ldo_vibr {
				regulator-name = "vibr";
				regulator-min-microvolt = <0x124f80>;
				regulator-max-microvolt = <0x325aa0>;
				regulator-enable-ramp-delay = <0x2c>;
				linux,phandle = <0x6e>;
				phandle = <0x6e>;
			};

			ldo_vusb33 {
				regulator-name = "vusb33";
				regulator-min-microvolt = <0x2dc6c0>;
				regulator-max-microvolt = <0x2f4d60>;
				regulator-enable-ramp-delay = <0x108>;
				linux,phandle = <0x6f>;
				phandle = <0x6f>;
			};
		};
	};

	scp@10500000 {
		compatible = "mediatek,scp";
		status = "okay";
		reg = <0x00 0x10500000 0x00 0x40000 0x00 0x105c0000 0x00 0x3000 0x00 0x105c4000 0x00 0x1000 0x00 0x105d4000 0x00 0x6000>;
		interrupts = <0x00 0x88 0x04>;
		core_1 = "enable";
		scp_sramSize = <0x40000>;
	};

	scp_dvfs {
		compatible = "mediatek,scp_dvfs";
		clocks = <0x19 0x6c 0x1b 0x19 0x10 0x19 0x1d 0x19 0x04 0x19 0x1a 0x19 0x08 0x19 0x1c>;
		clock-names = "clk_mux\0clk_pll_0\0clk_pll_1\0clk_pll_2\0clk_pll_3\0clk_pll_4\0clk_pll_5\0clk_pll_6";
	};

	sleep_reg_md@1000f000 {
		compatible = "mediatek,sleep_reg_md";
		reg = <0x00 0x1000f000 0x00 0x1000>;
	};

	kp@10010000 {
		compatible = "mediatek,kp";
		reg = <0x00 0x10010000 0x00 0x1000>;
		interrupts = <0x00 0x7c 0x02>;
		linux,phandle = <0x0e>;
		phandle = <0x0e>;
	};

	mrdump_ext_rst {
		compatible = "mediatek, mrdump_ext_rst-eint";
		source = "EINT";
		mode = "IRQ";
		status = "okay";
		linux,phandle = <0x70>;
		phandle = <0x70>;
	};

	touch {
		compatible = "mediatek,touch";
		linux,phandle = <0x71>;
		phandle = <0x71>;
	};

	accdet {
		compatible = "mediatek,pmic-accdet";
		linux,phandle = <0x72>;
		phandle = <0x72>;
	};

	mt6357_gauge {
		compatible = "mediatek,mt6357_gauge";
		gauge_name = "gauge";
		alias_name = "mt6357";
	};

	gauge_timer {
		compatible = "mediatek,gauge_timer_service";
	};

	battery {
		compatible = "mediatek,bat_gm30";
		DIFFERENCE_FULLOCV_ITH = <0xc8>;
		SHUTDOWN_1_TIME = <0x05>;
		KEEP_100_PERCENT = <0x01>;
		R_FG_VALUE = <0x0a>;
		EMBEDDED_SEL = <0x01>;
		PMIC_SHUTDOWN_CURRENT = <0x14>;
		FG_METER_RESISTANCE = <0x4b>;
		CAR_TUNE_VALUE = <0x64>;
		PMIC_MIN_VOL = <0x82dc>;
		POWERON_SYSTEM_IBOOT = <0x1f4>;
		SHUTDOWN_GAUGE0_VOLTAGE = <0x84d0>;
		TEMPERATURE_T0 = <0x32>;
		TEMPERATURE_T1 = <0x19>;
		TEMPERATURE_T2 = <0x0a>;
		TEMPERATURE_T3 = <0x00>;
		TEMPERATURE_T4 = <0xfffffff6>;
		g_FG_PSEUDO100_T0 = <0x64>;
		g_FG_PSEUDO100_T1 = <0x64>;
		g_FG_PSEUDO100_T2 = <0x64>;
		g_FG_PSEUDO100_T3 = <0x64>;
		g_FG_PSEUDO100_T4 = <0x64>;
		Q_MAX_SYS_VOLTAGE_BAT0 = <0xd16>;
		Q_MAX_SYS_VOLTAGE_BAT1 = <0xd16>;
		Q_MAX_SYS_VOLTAGE_BAT2 = <0xd16>;
		Q_MAX_SYS_VOLTAGE_BAT3 = <0xd16>;
		battery0_profile_t0_num = <0x64>;
		battery0_profile_t0 = <0x00 0xab5d 0x483 0x195 0xaacb 0x483 0x32a 0xaa4e 0x47b 0x4bf 0xa9d9 0x479 0x654 0xa965 0x476 0x7e9 0xa8f2 0x472 0x97d 0xa881 0x474 0xb12 0xa80d 0x477 0xca7 0xa798 0x477 0xe3c 0xa723 0x478 0xfd1 0xa6ae 0x478 0x1166 0xa639 0x47b 0x12fb 0xa5c3 0x47a 0x1490 0xa54d 0x47c 0x1625 0xa4d9 0x47d 0x17ba 0xa467 0x480 0x194f 0xa3f4 0x483 0x1ae3 0xa381 0x486 0x1c78 0xa310 0x48b 0x1e0d 0xa29f 0x48d 0x1fa2 0xa22e 0x490 0x2137 0xa1bf 0x495 0x22cc 0xa150 0x499 0x2461 0xa0e3 0x49d 0x25f6 0xa077 0x4a2 0x278b 0xa00c 0x4a7 0x2920 0x9fa2 0x4aa 0x2ab5 0x9f39 0x4af 0x2c49 0x9ed3 0x4b8 0x2dde 0x9e6e 0x4bc 0x2f73 0x9e0c 0x4c6 0x3108 0x9da8 0x4c7 0x329d 0x9d47 0x4d0 0x3432 0x9ce6 0x4d3 0x35c7 0x9c88 0x4d8 0x375c 0x9c2d 0x4e0 0x38f1 0x9bd3 0x4e5 0x3a86 0x9b7a 0x4ec 0x3c1b 0x9b21 0x4ef 0x3daf 0x9ac8 0x4f5 0x3f44 0x9a6f 0x4fb 0x40d9 0x9a10 0x4fa 0x426e 0x99a9 0x4f0 0x4403 0x9937 0x4d6 0x4598 0x98bf 0x4b5 0x472d 0x9850 0x499 0x48c2 0x97f1 0x486 0x4a57 0x979e 0x47c 0x4bec 0x9755 0x479 0x4d81 0x9711 0x478 0x4f15 0x96d2 0x475 0x50aa 0x9695 0x475 0x523f 0x965c 0x475 0x53d4 0x9625 0x474 0x5569 0x95f0 0x477 0x56fe 0x95be 0x47b 0x5893 0x958d 0x47c 0x5a28 0x955e 0x47d 0x5bbd 0x9531 0x482 0x5d52 0x9506 0x485 0x5ee7 0x94dc 0x48c 0x607b 0x94b5 0x493 0x6210 0x948e 0x499 0x63a5 0x9469 0x49e 0x653a 0x9445 0x4a3 0x66cf 0x9423 0x4ab 0x6864 0x9401 0x4b0 0x69f9 0x93df 0x4b3 0x6b8e 0x93be 0x4b5 0x6d23 0x939d 0x4b7 0x6eb8 0x9375 0x4b1 0x704d 0x9344 0x4a0 0x71e1 0x9305 0x489 0x7376 0x92c2 0x47a 0x750b 0x928c 0x47c 0x76a0 0x925e 0x47f 0x7835 0x9230 0x480 0x79ca 0x9201 0x47d 0x7b5f 0x91d5 0x47b 0x7cf4 0x91ad 0x47b 0x7e89 0x9188 0x47f 0x801e 0x9163 0x484 0x81b3 0x9139 0x487 0x8347 0x9105 0x484 0x84dc 0x90ca 0x482 0x8671 0x9091 0x485 0x8806 0x9058 0x488 0x899b 0x9013 0x486 0x8b30 0x8fcb 0x470 0x8cc5 0x8fa6 0x46c 0x8e5a 0x8f99 0x47f 0x8fef 0x8f8d 0x497 0x9184 0x8f7d 0x4ae 0x9319 0x8f63 0x4c9 0x94ad 0x8f2f 0x4e7 0x9642 0x8e8b 0x4c4 0x97d7 0x8d20 0x4a6 0x996c 0x8b30 0x4b2 0x9b01 0x88a2 0x4c8 0x9c96 0x8508 0x4f4>;
		battery0_profile_t1_num = <0x64>;
		battery0_profile_t1 = <0x00 0xabb6 0x62c 0x195 0xaaca 0x62c 0x32a 0xaa1b 0x627 0x4bf 0xa986 0x620 0x654 0xa8fb 0x61f 0x7e9 0xa876 0x617 0x97d 0xa7f5 0x614 0xb12 0xa779 0x619 0xca7 0xa6fd 0x613 0xe3c 0xa684 0x613 0xfd1 0xa60d 0x611 0x1166 0xa597 0x60f 0x12fb 0xa521 0x611 0x1490 0xa4ad 0x610 0x1625 0xa43a 0x609 0x17ba 0xa3c9 0x60a 0x194f 0xa358 0x60f 0x1ae3 0xa2e7 0x611 0x1c78 0xa279 0x615 0x1e0d 0xa20a 0x619 0x1fa2 0xa19d 0x61c 0x2137 0xa130 0x620 0x22cc 0xa0c2 0x629 0x2461 0xa056 0x62f 0x25f6 0x9fea 0x62f 0x278b 0x9f81 0x63a 0x2920 0x9f20 0x645 0x2ab5 0x9ece 0x65a 0x2c49 0x9e82 0x66d 0x2dde 0x9e1c 0x672 0x2f73 0x9d93 0x662 0x3108 0x9d00 0x657 0x329d 0x9c7a 0x652 0x3432 0x9c0d 0x657 0x35c7 0x9bbc 0x666 0x375c 0x9b7a 0x67b 0x38f1 0x9b37 0x68b 0x3a86 0x9aef 0x685 0x3c1b 0x9a9e 0x67f 0x3daf 0x9a46 0x67d 0x3f44 0x99e8 0x671 0x40d9 0x9987 0x65f 0x426e 0x9921 0x644 0x4403 0x98ba 0x629 0x4598 0x9857 0x607 0x472d 0x97f9 0x5eb 0x48c2 0x97a2 0x5d5 0x4a57 0x9753 0x5c7 0x4bec 0x970c 0x5bc 0x4d81 0x96ca 0x5b5 0x4f15 0x968c 0x5ae 0x50aa 0x9652 0x5aa 0x523f 0x961c 0x5b0 0x53d4 0x95e8 0x5b4 0x5569 0x95b7 0x5b2 0x56fe 0x9588 0x5ba 0x5893 0x955b 0x5c0 0x5a28 0x9530 0x5c2 0x5bbd 0x9507 0x5c9 0x5d52 0x94de 0x5ce 0x5ee7 0x94b9 0x5d6 0x607b 0x9494 0x5d5 0x6210 0x9470 0x5e4 0x63a5 0x944f 0x5eb 0x653a 0x942d 0x5e9 0x66cf 0x940d 0x5e6 0x6864 0x93ee 0x5eb 0x69f9 0x93d1 0x5f0 0x6b8e 0x93b4 0x5fa 0x6d23 0x9398 0x5fa 0x6eb8 0x937d 0x5f7 0x704d 0x9361 0x5f6 0x71e1 0x9347 0x5f8 0x7376 0x932b 0x5ef 0x750b 0x9310 0x5f3 0x76a0 0x92f1 0x5ec 0x7835 0x92cf 0x5e7 0x79ca 0x92a8 0x5e3 0x7b5f 0x9281 0x5e0 0x7cf4 0x925b 0x5e2 0x7e89 0x9237 0x5ec 0x801e 0x9210 0x5f5 0x81b3 0x91e3 0x5fb 0x8347 0x91ac 0x5ff 0x84dc 0x9170 0x604 0x8671 0x9135 0x60e 0x8806 0x90fa 0x621 0x899b 0x90b2 0x62e 0x8b30 0x9061 0x62c 0x8cc5 0x902c 0x632 0x8e5a 0x9014 0x64c 0x8fef 0x9001 0x66d 0x9184 0x8fec 0x69a 0x9319 0x8fcd 0x6cf 0x94ad 0x8f90 0x705 0x9642 0x8ef1 0x725 0x97d7 0x8d7e 0x71d 0x996c 0x8b64 0x759 0x9b01 0x888d 0x7c0 0x9c96 0x8460 0x878>;
		battery0_profile_t2_num = <0x64>;
		battery0_profile_t2 = <0x00 0xab98 0xc71 0x195 0xaa87 0xc70 0x32a 0xa9c2 0xc4f 0x4bf 0xa91c 0xc33 0x654 0xa888 0xc07 0x7e9 0xa7fc 0xbfa 0x97d 0xa779 0xbde 0xb12 0xa6fb 0xbc7 0xca7 0xa680 0xbac 0xe3c 0xa607 0xb8d 0xfd1 0xa590 0xb74 0x1166 0xa51b 0xb60 0x12fb 0xa4a8 0xb3f 0x1490 0xa436 0xb31 0x1625 0xa3c5 0xb22 0x17ba 0xa356 0xb10 0x194f 0xa2e8 0xaff 0x1ae3 0xa27a 0xaeb 0x1c78 0xa20d 0xad9 0x1e0d 0xa19f 0xace 0x1fa2 0xa132 0xad1 0x2137 0xa0c6 0xac9 0x22cc 0xa05a 0xabe 0x2461 0x9ff2 0xaaa 0x25f6 0x9f90 0xaaa 0x278b 0x9f38 0xaba 0x2920 0x9ee3 0xad0 0x2ab5 0x9e82 0xad7 0x2c49 0x9e0c 0xac8 0x2dde 0x9d82 0xaab 0x2f73 0x9cee 0xa81 0x3108 0x9c5e 0xa5a 0x329d 0x9be1 0xa42 0x3432 0x9b73 0xa3a 0x35c7 0x9b19 0xa2f 0x375c 0x9ac6 0xa2a 0x38f1 0x9a76 0xa20 0x3a86 0x9a27 0xa18 0x3c1b 0x99d5 0xa0d 0x3daf 0x9980 0x9ef 0x3f44 0x9929 0x9d7 0x40d9 0x98d1 0x9bb 0x426e 0x987b 0x9a1 0x4403 0x9828 0x98d 0x4598 0x97d8 0x97c 0x472d 0x978b 0x973 0x48c2 0x9743 0x962 0x4a57 0x96ff 0x963 0x4bec 0x96c0 0x963 0x4d81 0x9682 0x957 0x4f15 0x9648 0x95a 0x50aa 0x9611 0x961 0x523f 0x95dc 0x968 0x53d4 0x95a9 0x96d 0x5569 0x9578 0x96e 0x56fe 0x954a 0x971 0x5893 0x951f 0x977 0x5a28 0x94f4 0x982 0x5bbd 0x94cb 0x98b 0x5d52 0x94a4 0x999 0x5ee7 0x947e 0x99a 0x607b 0x945b 0x9a2 0x6210 0x9439 0x9a6 0x63a5 0x9419 0x9ab 0x653a 0x93fb 0x9ab 0x66cf 0x93e1 0x9bc 0x6864 0x93c9 0x9cc 0x69f9 0x93b3 0x9e5 0x6b8e 0x939d 0x9f4 0x6d23 0x9389 0xa04 0x6eb8 0x9374 0xa15 0x704d 0x935f 0xa23 0x71e1 0x934a 0xa3c 0x7376 0x9332 0xa44 0x750b 0x9319 0xa5f 0x76a0 0x92fd 0xa80 0x7835 0x92df 0xa9a 0x79ca 0x92bf 0xab0 0x7b5f 0x929b 0xacc 0x7cf4 0x9276 0xaee 0x7e89 0x924c 0xb10 0x801e 0x921d 0xb3c 0x81b3 0x91e9 0xb6b 0x8347 0x91b0 0xba1 0x84dc 0x9171 0xbe7 0x8671 0x9130 0xc25 0x8806 0x90eb 0xc75 0x899b 0x90a4 0xcc6 0x8b30 0x9062 0xd22 0x8cc5 0x9029 0xda1 0x8e5a 0x8ffb 0xe39 0x8fef 0x8fcf 0xedc 0x9184 0x8f99 0xf98 0x9319 0x8f4a 0x1091 0x94ad 0x8ec7 0x1176 0x9642 0x8dd8 0x1263 0x97d7 0x8c53 0x134c 0x996c 0x8a1c 0x14ef 0x9b01 0x86fd 0x174a 0x9c96 0x822f 0x1b1f>;
		battery0_profile_t3_num = <0x64>;
		battery0_profile_t3 = <0x00 0xabee 0x1548 0x195 0xab03 0x1548 0x32a 0xaa50 0x1548 0x4bf 0xa9b2 0x1529 0x654 0xa921 0x1502 0x7e9 0xa896 0x14cd 0x97d 0xa810 0x14a8 0xb12 0xa791 0x1479 0xca7 0xa715 0x1459 0xe3c 0xa69b 0x1419 0xfd1 0xa624 0x13fb 0x1166 0xa5ac 0x13c9 0x12fb 0xa538 0x13ab 0x1490 0xa4c3 0x138a 0x1625 0xa451 0x136b 0x17ba 0xa3e1 0x1356 0x194f 0xa373 0x1336 0x1ae3 0xa305 0x1311 0x1c78 0xa297 0x12e9 0x1e0d 0xa228 0x12ca 0x1fa2 0xa1bb 0x12bd 0x2137 0xa14e 0x12a5 0x22cc 0xa0e1 0x1284 0x2461 0xa076 0x1270 0x25f6 0xa010 0x125c 0x278b 0x9fb4 0x1255 0x2920 0x9f60 0x126a 0x2ab5 0x9f0a 0x127a 0x2c49 0x9ea5 0x1272 0x2dde 0x9e26 0x123d 0x2f73 0x9d92 0x1207 0x3108 0x9cf5 0x11b0 0x329d 0x9c61 0x116e 0x3432 0x9bde 0x113d 0x35c7 0x9b6d 0x1128 0x375c 0x9b0e 0x1112 0x38f1 0x9aba 0x1114 0x3a86 0x9a6a 0x110e 0x3c1b 0x9a1a 0x110f 0x3daf 0x99c8 0x10e8 0x3f44 0x9975 0x10c5 0x40d9 0x991e 0x10b2 0x426e 0x98c8 0x1087 0x4403 0x9872 0x1066 0x4598 0x9820 0x1047 0x472d 0x97d0 0x1051 0x48c2 0x9784 0x1067 0x4a57 0x973c 0x1035 0x4bec 0x96f9 0x1022 0x4d81 0x96b9 0x1021 0x4f15 0x967c 0x1023 0x50aa 0x9643 0x1027 0x523f 0x960c 0x101f 0x53d4 0x95d8 0x1025 0x5569 0x95a6 0x103e 0x56fe 0x9577 0x1039 0x5893 0x9549 0x1046 0x5a28 0x951e 0x105a 0x5bbd 0x94f5 0x1058 0x5d52 0x94cd 0x1074 0x5ee7 0x94a8 0x107a 0x607b 0x9484 0x1097 0x6210 0x9462 0x1098 0x63a5 0x9442 0x10c5 0x653a 0x9427 0x10b4 0x66cf 0x940c 0x111b 0x6864 0x93f3 0x116f 0x69f9 0x93de 0x119a 0x6b8e 0x93ca 0x11c5 0x6d23 0x93b7 0x11e7 0x6eb8 0x93a5 0x120e 0x704d 0x9391 0x123b 0x71e1 0x937e 0x1272 0x7376 0x9368 0x1292 0x750b 0x9351 0x12ca 0x76a0 0x9339 0x12fa 0x7835 0x931c 0x1325 0x79ca 0x92fe 0x136e 0x7b5f 0x92de 0x13b4 0x7cf4 0x92b9 0x13fa 0x7e89 0x9291 0x1446 0x801e 0x9263 0x1497 0x81b3 0x9232 0x14fd 0x8347 0x91fc 0x1563 0x84dc 0x91c2 0x15d3 0x8671 0x9185 0x164a 0x8806 0x9143 0x16db 0x899b 0x90fe 0x1769 0x8b30 0x90bd 0x180a 0x8cc5 0x9085 0x18d2 0x8e5a 0x9054 0x19ad 0x8fef 0x9027 0x1ac4 0x9184 0x8ffa 0x1be1 0x9319 0x8fc2 0x1d4a 0x94ad 0x8f67 0x1eba 0x9642 0x8ec7 0x2056 0x97d7 0x8dbe 0x21e3 0x996c 0x8c30 0x23b1 0x9b01 0x8a00 0x2685 0x9c96 0x86e5 0x2a8a>;
		battery0_profile_t4_num = <0x64>;
		battery0_profile_t4 = <0x00 0xac1e 0x26aa 0x195 0xab04 0x26ac 0x32a 0xaa2c 0x2705 0x4bf 0xa970 0x26ed 0x654 0xa8c5 0x26b8 0x7e9 0xa827 0x266c 0x97d 0xa78f 0x2612 0xb12 0xa700 0x25c3 0xca7 0xa677 0x2553 0xe3c 0xa5f3 0x2482 0xfd1 0xa572 0x240a 0x1166 0xa4f3 0x23d5 0x12fb 0xa477 0x23aa 0x1490 0xa3fd 0x2382 0x1625 0xa386 0x2350 0x17ba 0xa30f 0x2316 0x194f 0xa29a 0x22d6 0x1ae3 0xa225 0x228e 0x1c78 0xa1b1 0x223c 0x1e0d 0xa140 0x21eb 0x1fa2 0xa0d6 0x21c1 0x2137 0xa071 0x21d8 0x22cc 0xa00b 0x2236 0x2461 0x9f9f 0x2251 0x25f6 0x9f26 0x2219 0x278b 0x9e9c 0x21c0 0x2920 0x9e06 0x2151 0x2ab5 0x9d6d 0x20d7 0x2c49 0x9cdb 0x206e 0x2dde 0x9c56 0x2013 0x2f73 0x9bde 0x1fd6 0x3108 0x9b71 0x1fab 0x329d 0x9b10 0x1f91 0x3432 0x9ab6 0x1f89 0x35c7 0x9a63 0x1f83 0x375c 0x9a0e 0x1f73 0x38f1 0x99bd 0x1f61 0x3a86 0x996a 0x1f4e 0x3c1b 0x9919 0x1f46 0x3daf 0x98ca 0x1f3c 0x3f44 0x987b 0x1f2f 0x40d9 0x9838 0x1f0f 0x426e 0x9809 0x1ec8 0x4403 0x97b3 0x1e75 0x4598 0x9769 0x1e38 0x472d 0x9725 0x1e4c 0x48c2 0x96e3 0x1e53 0x4a57 0x96a4 0x1e56 0x4bec 0x9669 0x1e5c 0x4d81 0x9631 0x1e58 0x4f15 0x95fc 0x1e5e 0x50aa 0x95c9 0x1e6e 0x523f 0x9598 0x1e7f 0x53d4 0x956a 0x1e99 0x5569 0x9540 0x1eaf 0x56fe 0x9518 0x1ed0 0x5893 0x94f4 0x1eec 0x5a28 0x94d3 0x1f07 0x5bbd 0x94b6 0x1f2a 0x5d52 0x949a 0x1f55 0x5ee7 0x9480 0x1f81 0x607b 0x9467 0x1fbb 0x6210 0x944f 0x1ff5 0x63a5 0x9439 0x2037 0x653a 0x9418 0x205d 0x66cf 0x9411 0x2165 0x6864 0x93f9 0x216e 0x69f9 0x93e2 0x21a0 0x6b8e 0x93cd 0x2206 0x6d23 0x93b6 0x227e 0x6eb8 0x939f 0x22ed 0x704d 0x9387 0x235a 0x71e1 0x936d 0x23c3 0x7376 0x9353 0x2434 0x750b 0x9337 0x24b3 0x76a0 0x931a 0x2536 0x7835 0x92fa 0x25c1 0x79ca 0x92d9 0x264f 0x7b5f 0x92b5 0x26fb 0x7cf4 0x928e 0x27b1 0x7e89 0x9266 0x2873 0x801e 0x923a 0x2941 0x81b3 0x920b 0x2a15 0x8347 0x91da 0x2afc 0x84dc 0x91a5 0x2bee 0x8671 0x916d 0x2cf5 0x8806 0x9133 0x2e11 0x899b 0x90f7 0x2f41 0x8b30 0x90bc 0x3097 0x8cc5 0x9081 0x3210 0x8e5a 0x9048 0x33ae 0x8fef 0x900e 0x355f 0x9184 0x8fce 0x3718 0x9319 0x8f7f 0x38d5 0x94ad 0x8f0f 0x3a97 0x9642 0x8e66 0x3c27 0x97d7 0x8d66 0x3d8a 0x996c 0x8bf0 0x3ef6 0x9b01 0x89dc 0x4102 0x9c96 0x86da 0x4496>;
		battery1_profile_t0_num = <0x64>;
		battery1_profile_t0 = <0x00 0xaaaa 0x433 0x191 0xaa0a 0x433 0x322 0xa974 0x433 0x4b3 0xa8e8 0x433 0x644 0xa85c 0x433 0x7d5 0xa7d0 0x433 0x966 0xa74e 0x44c 0xaf7 0xa6cc 0x44c 0xc88 0xa64a 0x44c 0xe19 0xa5c8 0x44c 0xfaa 0xa546 0x44c 0x113b 0xa4c4 0x44c 0x12cc 0xa44c 0x465 0x145d 0xa3ca 0x44c 0x15ee 0xa352 0x465 0x177f 0xa2da 0x465 0x1910 0xa258 0x44c 0x1aa1 0xa1ea 0x465 0x1c32 0xa172 0x465 0x1dc3 0xa0fa 0x465 0x1f54 0xa082 0x465 0x20e5 0xa014 0x47e 0x2276 0x9f9c 0x465 0x2407 0x9f2e 0x47e 0x2598 0x9ec0 0x47e 0x2729 0x9e52 0x47e 0x28ba 0x9dee 0x497 0x2a4b 0x9d80 0x47e 0x2bdc 0x9d1c 0x497 0x2d6d 0x9cb8 0x497 0x2efe 0x9c54 0x4b0 0x308f 0x9bfa 0x4b0 0x3220 0x9b96 0x4b0 0x33b1 0x9b3c 0x4b0 0x3542 0x9ae2 0x4c9 0x36d3 0x9a92 0x4e2 0x3864 0x9a38 0x4e2 0x39f5 0x99e8 0x4fb 0x3b86 0x9998 0x514 0x3d17 0x9948 0x52d 0x3ea8 0x98ee 0x52d 0x4039 0x9894 0x52d 0x41ca 0x9830 0x52d 0x435b 0x97a4 0x4e2 0x44ec 0x9718 0x497 0x467d 0x96b4 0x47e 0x480e 0x9664 0x47e 0x499f 0x961e 0x465 0x4b30 0x95d8 0x44c 0x4cc1 0x95a6 0x465 0x4e52 0x956a 0x44c 0x4fe3 0x9538 0x465 0x5174 0x9506 0x44c 0x5305 0x94de 0x465 0x5496 0x94ac 0x465 0x5627 0x9484 0x465 0x57b8 0x9466 0x47e 0x5949 0x943e 0x47e 0x5ada 0x9416 0x465 0x5c6b 0x93f8 0x47e 0x5dfc 0x93da 0x47e 0x5f8d 0x93bc 0x47e 0x611e 0x93a8 0x497 0x62af 0x9394 0x497 0x6440 0x9380 0x4b0 0x65d1 0x936c 0x4b0 0x6762 0x9358 0x4b0 0x68f3 0x934e 0x4b0 0x6a84 0x9344 0x4c9 0x6c15 0x933a 0x4c9 0x6da6 0x931c 0x4b0 0x6f37 0x92ea 0x47e 0x70c8 0x92a4 0x465 0x7259 0x927c 0x47e 0x73ea 0x925e 0x47e 0x757b 0x9240 0x47e 0x770c 0x9218 0x47e 0x789d 0x91f0 0x47e 0x7a2e 0x91d2 0x47e 0x7bbf 0x91aa 0x47e 0x7d50 0x918c 0x47e 0x7ee1 0x916e 0x497 0x8072 0x913c 0x497 0x8203 0x9100 0x497 0x8394 0x90ba 0x47e 0x8525 0x907e 0x497 0x86b6 0x9042 0x4b0 0x8847 0x8fde 0x4b0 0x89d8 0x8f8e 0x4c9 0x8b69 0x8f3e 0x4e2 0x8cfa 0x8e94 0x4e2 0x8e8b 0x8d9a 0x514 0x901c 0x8c6e 0x52d 0x91ad 0x8b42 0x514 0x933e 0x8a34 0x514 0x94cf 0x88c2 0x4fb 0x9660 0x8692 0x4fb 0x97f1 0x83e0 0x52d 0x9982 0x8066 0x546 0x9b13 0x7b48 0x5aa>;
		battery1_profile_t1_num = <0x64>;
		battery1_profile_t1 = <0x00 0xaabe 0x578 0x191 0xaa28 0x578 0x322 0xa99b 0x578 0x4b3 0xa905 0x55f 0x644 0xa883 0x578 0x7d5 0xa7f6 0x55f 0x966 0xa76a 0x546 0xaf7 0xa6e8 0x55f 0xc88 0xa665 0x578 0xe19 0xa5e3 0x578 0xfaa 0xa561 0x578 0x113b 0xa4df 0x579 0x12cc 0xa466 0x590 0x145d 0xa3e4 0x55f 0x15ee 0xa362 0x560 0x177f 0xa2f4 0x579 0x1910 0xa27b 0x591 0x1aa1 0xa1f9 0x591 0x1c32 0xa18b 0x591 0x1dc3 0xa112 0x592 0x1f54 0xa09a 0x5a9 0x20e5 0xa022 0x594 0x2276 0x9fb4 0x5c4 0x2407 0x9f47 0x5dc 0x2598 0x9eee 0x5e0 0x2729 0x9eaf 0x625 0x28ba 0x9e3e 0x60c 0x2a4b 0x9d9d 0x5f7 0x2bdc 0x9cfe 0x60e 0x2d6d 0x9c6a 0x610 0x2efe 0x9bfe 0x629 0x308f 0x9bb0 0x642 0x3220 0x9b7d 0x65d 0x33b1 0x9b3f 0x689 0x3542 0x9aee 0x672 0x36d3 0x9a95 0x676 0x3864 0x9a45 0x6a6 0x39f5 0x99f5 0x6bd 0x3b86 0x99a3 0x6bb 0x3d17 0x994a 0x6a9 0x3ea8 0x98f8 0x6d6 0x4039 0x9893 0x6ce 0x41ca 0x9824 0x688 0x435b 0x97b4 0x665 0x44ec 0x9733 0x5ed 0x467d 0x96bd 0x5a2 0x480e 0x965d 0x565 0x499f 0x961f 0x588 0x4b30 0x95d2 0x54c 0x4cc1 0x959f 0x575 0x4e52 0x9563 0x55c 0x4fe3 0x9529 0x549 0x5174 0x9501 0x562 0x5305 0x94d7 0x575 0x5496 0x94a7 0x562 0x5627 0x947f 0x575 0x57b8 0x9458 0x562 0x5949 0x943a 0x578 0x5ada 0x941a 0x578 0x5c6b 0x93f5 0x57c 0x5dfc 0x93e0 0x591 0x5f8d 0x93c4 0x595 0x611e 0x93b7 0x5aa 0x62af 0x939b 0x5a6 0x6440 0x9388 0x595 0x65d1 0x937e 0x5aa 0x6762 0x9376 0x5b2 0x68f3 0x9374 0x5dc 0x6a84 0x936c 0x5e0 0x6c15 0x9369 0x5f1 0x6da6 0x9356 0x5dc 0x6f37 0x934a 0x5dc 0x70c8 0x9336 0x5dc 0x7259 0x9322 0x5dc 0x73ea 0x930b 0x5d7 0x757b 0x92e4 0x5c3 0x770c 0x92c4 0x5c3 0x789d 0x929c 0x5be 0x7a2e 0x9274 0x5af 0x7bbf 0x924e 0x5c3 0x7d50 0x9230 0x5c8 0x7ee1 0x9210 0x5e1 0x8072 0x91e4 0x5fa 0x8203 0x91a5 0x60e 0x8394 0x915f 0x613 0x8525 0x9119 0x62c 0x86b6 0x90cf 0x650 0x8847 0x906c 0x696 0x89d8 0x8fe5 0x6c8 0x8b69 0x8f48 0x705 0x8cfa 0x8e7f 0x759 0x8e8b 0x8d65 0x75b 0x901c 0x8c2b 0x721 0x91ad 0x8b14 0x721 0x933e 0x8a21 0x727 0x94cf 0x8908 0x73a 0x9660 0x8751 0x752 0x97f1 0x84c2 0x7c8 0x9982 0x8183 0x89d 0x9b13 0x7e72 0x992>;
		battery1_profile_t2_num = <0x64>;
		battery1_profile_t2 = <0x00 0xaabe 0x8b1 0x191 0xaa28 0x8b1 0x322 0xa991 0x8b1 0x4b3 0xa905 0x898 0x644 0xa879 0x87f 0x7d5 0xa7ec 0x866 0x966 0xa76a 0x866 0xaf7 0xa6e8 0x866 0xc88 0xa665 0x866 0xe19 0xa5e3 0x865 0xfaa 0xa561 0x84e 0x113b 0xa4e8 0x865 0x12cc 0xa466 0x84d 0x145d 0xa3ee 0x84d 0x15ee 0xa376 0x84d 0x177f 0xa2fe 0x84d 0x1910 0xa286 0x84e 0x1aa1 0xa217 0x866 0x1c32 0xa19f 0x866 0x1dc3 0xa126 0x867 0x1f54 0xa0af 0x87f 0x20e5 0xa040 0x880 0x2276 0x9fd3 0x899 0x2407 0x9f7b 0x8b4 0x2598 0x9f3d 0x8e6 0x2729 0x9ee9 0x912 0x28ba 0x9e5a 0x8e1 0x2a4b 0x9da6 0x8ca 0x2bdc 0x9cf4 0x8ca 0x2d6d 0x9c5f 0x8cc 0x2efe 0x9be9 0x8e5 0x308f 0x9b86 0x8fe 0x3220 0x9b38 0x917 0x33b1 0x9b06 0x932 0x3542 0x9ad2 0x95e 0x36d3 0x9a8b 0x947 0x3864 0x9a3a 0x945 0x39f5 0x99e0 0x92e 0x3b86 0x9985 0x92c 0x3d17 0x9920 0x910 0x3ea8 0x98bb 0x8de 0x4039 0x984d 0x8a9 0x41ca 0x97e0 0x861 0x435b 0x977b 0x82f 0x44ec 0x9718 0x7fd 0x467d 0x96bf 0x7d0 0x480e 0x9670 0x7cd 0x499f 0x962b 0x7b7 0x4b30 0x95ef 0x7b7 0x4cc1 0x95b3 0x7b7 0x4e52 0x9578 0x7b7 0x4fe3 0x9546 0x7b7 0x5174 0x9515 0x7b7 0x5305 0x94ed 0x7ba 0x5496 0x94c5 0x7d0 0x5627 0x949d 0x7d0 0x57b8 0x9476 0x7d3 0x5949 0x9458 0x7e9 0x5ada 0x943a 0x7ed 0x5c6b 0x941c 0x7f0 0x5dfc 0x93ff 0x798 0x5f8d 0x93eb 0x806 0x611e 0x93d7 0x81b 0x62af 0x93c4 0x81b 0x6440 0x93bc 0x81f 0x65d1 0x93ba 0x838 0x6762 0x93b0 0x84d 0x68f3 0x93a8 0x851 0x6a84 0x93a6 0x86a 0x6c15 0x939c 0x87f 0x6da6 0x9392 0x883 0x6f37 0x9388 0x89c 0x70c8 0x937e 0x8b5 0x7259 0x9372 0x8ca 0x73ea 0x935c 0x8ca 0x757b 0x933e 0x8ca 0x770c 0x9320 0x8cf 0x789d 0x9300 0x8e3 0x7a2e 0x92d8 0x8e8 0x7bbf 0x92b0 0x906 0x7d50 0x9288 0x933 0x7ee1 0x925c 0x951 0x8072 0x9220 0x988 0x8203 0x91df 0x9d4 0x8394 0x918f 0xa24 0x8525 0x913b 0xa88 0x86b6 0x90d2 0xaf2 0x8847 0x9053 0xb75 0x89d8 0x8fb4 0xbfa 0x8b69 0x8ef1 0xc46 0x8cfa 0x8e11 0xc75 0x8e8b 0x8cfe 0xc43 0x901c 0x8be2 0xc1c 0x91ad 0x8ae7 0xc33 0x933e 0x8a0d 0xcb5 0x94cf 0x8920 0xd8b 0x9660 0x87a3 0xe5e 0x97f1 0x853f 0x1029 0x9982 0x8223 0x1524 0x9b13 0x7f4e 0x1c84>;
		battery1_profile_t3_num = <0x64>;
		battery1_profile_t3 = <0x00 0xaad2 0xf3c 0x191 0xaa1e 0xf3c 0x322 0xa987 0xf23 0x4b3 0xa8f1 0xf0a 0x644 0xa865 0xed8 0x7d5 0xa7d8 0xebe 0x966 0xa74c 0xe8d 0xaf7 0xa6d4 0xe8d 0xc88 0xa651 0xe73 0xe19 0xa5cf 0xe41 0xfaa 0xa54d 0xe28 0x113b 0xa4d4 0xe0f 0x12cc 0xa452 0xdf6 0x145d 0xa3da 0xdde 0x15ee 0xa36c 0xddd 0x177f 0xa2f4 0xdc5 0x1910 0xa27c 0xdc5 0x1aa1 0xa20d 0xdc5 0x1c32 0xa195 0xdc5 0x1dc3 0xa11d 0xdc5 0x1f54 0xa0ae 0xdc5 0x20e5 0xa037 0xdc6 0x2276 0x9fd3 0xdde 0x2407 0x9f7b 0xde2 0x2598 0x9f3d 0xe2c 0x2729 0x9edf 0xe58 0x28ba 0x9e46 0xe26 0x2a4b 0x9d91 0xdf4 0x2bdc 0x9cd5 0xdc5 0x2d6d 0x9c36 0xdc1 0x2efe 0x9bad 0xd95 0x308f 0x9b49 0xdae 0x3220 0x9af0 0xdc5 0x33b1 0x9aa1 0xdc7 0x3542 0x9a65 0xdde 0x36d3 0x9a27 0xddc 0x3864 0x99d6 0xdc1 0x39f5 0x997b 0xd8c 0x3b86 0x9917 0xd46 0x3d17 0x98b2 0xd2a 0x3ea8 0x984f 0xcfb 0x4039 0x97f4 0xcdf 0x41ca 0x9791 0xcad 0x435b 0x9737 0xc80 0x44ec 0x96e7 0xc7d 0x467d 0x9698 0xc64 0x480e 0x9652 0xc4e 0x499f 0x960d 0xc4e 0x4b30 0x95d1 0xc4e 0x4cc1 0x9596 0xc4e 0x4e52 0x9564 0xc51 0x4fe3 0x9532 0xc67 0x5174 0x9501 0xc6a 0x5305 0x94d9 0xc83 0x5496 0x94b1 0xc99 0x5627 0x9489 0xc9c 0x57b8 0x9462 0xcb5 0x5949 0x9442 0xcc7 0x5ada 0x941d 0xcb9 0x5c6b 0x9408 0xce4 0x5dfc 0x93eb 0xce8 0x5f8d 0x93d8 0xd05 0x611e 0x93ce 0xd33 0x62af 0x93c4 0xd4c 0x6440 0x93ba 0xd65 0x65d1 0x93b0 0xd7e 0x6762 0x93a8 0xd9f 0x68f3 0x93a6 0xde2 0x6a84 0x939c 0xdff 0x6c15 0x9391 0xe2d 0x6da6 0x937e 0xe4b 0x6f37 0x9374 0xe7d 0x70c8 0x9368 0xeaf 0x7259 0x9354 0xee6 0x73ea 0x933e 0xf28 0x757b 0x9320 0xf4a 0x770c 0x9302 0xf90 0x789d 0x92e4 0xfcc 0x7a2e 0x92c2 0x102c 0x7bbf 0x9290 0x107c 0x7d50 0x925c 0x10e0 0x7ee1 0x921e 0x1149 0x8072 0x91d6 0x11c7 0x8203 0x9183 0x1249 0x8394 0x9123 0x12da 0x8525 0x90ab 0x1362 0x86b6 0x902c 0x140c 0x8847 0x8f8d 0x1492 0x89d8 0x8ec8 0x14dd 0x8b69 0x8de7 0x151e 0x8cfa 0x8cf8 0x1542 0x8e8b 0x8c14 0x159e 0x901c 0x8b3a 0x1646 0x91ad 0x8a6a 0x174a 0x933e 0x89a1 0x18eb 0x94cf 0x88c6 0x1b54 0x9660 0x8776 0x1f1f 0x97f1 0x8543 0x2730 0x9982 0x824e 0x3a06 0x9b13 0x8106 0x44a7>;
		battery1_profile_t4_num = <0x64>;
		battery1_profile_t4 = <0x00 0xaae6 0x2247 0x191 0xaa1e 0x2247 0x322 0xa969 0x222e 0x4b3 0xa8c9 0x21c9 0x644 0xa829 0x2165 0x7d5 0xa79c 0x2119 0x966 0xa710 0x209d 0xaf7 0xa68e 0x2038 0xc88 0xa601 0x1fbb 0xe19 0xa57f 0x1f40 0xfaa 0xa4fd 0x1f3e 0x113b 0xa484 0x1ef3 0x12cc 0xa402 0x1ea8 0x145d 0xa38a 0x1e5b 0x15ee 0xa31c 0x1ddf 0x177f 0xa2a4 0x1d94 0x1910 0xa22b 0x1d4d 0x1aa1 0xa1b3 0x1d62 0x1c32 0xa13b 0x1d17 0x1dc3 0xa0c2 0x1cca 0x1f54 0xa04b 0x1c6b 0x20e5 0x9fe7 0x1c6b 0x2276 0x9f8d 0x1c6a 0x2407 0x9f32 0x1c52 0x2598 0x9ecb 0x1c4b 0x2729 0x9e33 0x1bcd 0x28ba 0x9d7e 0x1b50 0x2a4b 0x9cc0 0x1ad3 0x2bdc 0x9c0e 0x1a5b 0x2d6d 0x9b79 0x1a2a 0x2efe 0x9af8 0x1a11 0x308f 0x9a8a 0x19fa 0x3220 0x9a28 0x19fe 0x33b1 0x99e1 0x1a2c 0x3542 0x9992 0x1a2c 0x36d3 0x994b 0x1a2a 0x3864 0x98fb 0x1a11 0x39f5 0x98ab 0x19f8 0x3b86 0x985a 0x19e1 0x3d17 0x980a 0x19e1 0x3ea8 0x97ba 0x19e1 0x4039 0x976a 0x19de 0x41ca 0x971a 0x19c8 0x435b 0x96ca 0x19c8 0x44ec 0x9685 0x19cb 0x467d 0x9648 0x19e1 0x480e 0x9603 0x19e4 0x499f 0x95c7 0x19fd 0x4b30 0x958c 0x1a16 0x4cc1 0x9559 0x1a2f 0x4e52 0x951e 0x1a45 0x4fe3 0x94ed 0x1a4f 0x5174 0x94c4 0x1a90 0x5305 0x9493 0x1a93 0x5496 0x946b 0x1ab0 0x5627 0x9444 0x1ae2 0x57b8 0x9426 0x1b14 0x5949 0x9409 0x1b4a 0x5ada 0x93f5 0x1b95 0x5c6b 0x93e1 0x1be0 0x5dfc 0x93cd 0x1c2b 0x5f8d 0x93ba 0x1c7a 0x611e 0x93af 0x1cdb 0x62af 0x939c 0x1d2e 0x6440 0x9391 0x1da7 0x65d1 0x937d 0x1e07 0x6762 0x9369 0x1e5b 0x68f3 0x9355 0x1ed4 0x6a84 0x9341 0x1f3c 0x6c15 0x932b 0x1fb5 0x6da6 0x930d 0x201e 0x6f37 0x92ef 0x20a0 0x70c8 0x92d1 0x2136 0x7259 0x92b1 0x21d1 0x73ea 0x9289 0x227c 0x757b 0x925f 0x2317 0x770c 0x922d 0x23c6 0x789d 0x91f7 0x2476 0x7a2e 0x91b0 0x252a 0x7bbf 0x9168 0x25f7 0x7d50 0x9116 0x26d4 0x7ee1 0x90ba 0x27a2 0x8072 0x904f 0x287e 0x8203 0x8fcd 0x2951 0x8394 0x8f47 0x2a41 0x8525 0x8eae 0x2b14 0x86b6 0x8e0b 0x2c0f 0x8847 0x8d61 0x2d1a 0x89d8 0x8cb7 0x2e5f 0x8b69 0x8c0e 0x2fb6 0x8cfa 0x8b70 0x315d 0x8e8b 0x8adc 0x3375 0x901c 0x8a50 0x362e 0x91ad 0x89c1 0x39da 0x933e 0x8921 0x3f44 0x94cf 0x8850 0x484f 0x9660 0x8731 0x5334 0x97f1 0x85de 0x50c3 0x9982 0x85de 0x50c3 0x9b13 0x85de 0x50c3>;
		battery2_profile_t0_num = <0x64>;
		battery2_profile_t0 = <0x00 0xaa76 0x535 0x18e 0xa9ea 0x535 0x31c 0xa954 0x538 0x4aa 0xa8d5 0x555 0x638 0xa857 0x555 0x7c5 0xa7da 0x55b 0x953 0xa767 0x591 0xae1 0xa6f3 0x591 0xc6f 0xa677 0x591 0xdfd 0xa603 0x58e 0xf8b 0xa587 0x579 0x1119 0xa515 0x592 0x12a7 0xa4a4 0x58c 0x1434 0xa432 0x57b 0x15c2 0xa3c3 0x59a 0x1750 0xa356 0x5a8 0x18de 0xa2e0 0x59c 0x1a6c 0xa27b 0x5b2 0x1bfa 0xa20d 0x5a7 0x1d88 0xa198 0x59f 0x1f16 0xa133 0x5b0 0x20a3 0xa0c8 0x5a3 0x2231 0xa05c 0x5a1 0x23bf 0x9ffd 0x5c1 0x254d 0x9f9e 0x5d2 0x26db 0x9f38 0x5e0 0x2869 0x9ed3 0x5ef 0x29f7 0x9e75 0x5ef 0x2b85 0x9e15 0x5ef 0x2d12 0x9db7 0x602 0x2ea0 0x9d5e 0x60e 0x302e 0x9d0e 0x621 0x31bc 0x9cb2 0x62e 0x334a 0x9c5d 0x641 0x34d8 0x9c09 0x637 0x3666 0x9bb9 0x644 0x37f4 0x9b64 0x64b 0x3982 0x9b15 0x662 0x3b0f 0x9ad2 0x683 0x3c9d 0x9a8a 0x68b 0x3e2b 0x9a34 0x6a3 0x3fb9 0x99db 0x690 0x4147 0x9978 0x66f 0x42d5 0x98f2 0x61a 0x4463 0x987d 0x5f3 0x45f1 0x9817 0x5f0 0x477e 0x97bd 0x5f0 0x490c 0x977c 0x60c 0x4a9a 0x973d 0x62e 0x4c28 0x970a 0x62c 0x4db6 0x96cb 0x62c 0x4f44 0x9698 0x62f 0x50d2 0x9665 0x64c 0x5260 0x9633 0x64a 0x53ed 0x960d 0x64d 0x557b 0x95dc 0x64c 0x5709 0x95b5 0x64a 0x5897 0x958f 0x651 0x5a25 0x9567 0x66b 0x5bb3 0x9537 0x66b 0x5d41 0x9514 0x66b 0x5ecf 0x94f7 0x66b 0x605c 0x94d5 0x672 0x61ea 0x94bb 0x692 0x6378 0x94a3 0x6ab 0x6506 0x9489 0x6a9 0x6694 0x9470 0x6b3 0x6822 0x9456 0x6c7 0x69b0 0x943d 0x6d3 0x6b3e 0x941a 0x6cf 0x6ccc 0x93e7 0x69c 0x6e59 0x93aa 0x661 0x6fe7 0x935e 0x612 0x7175 0x9324 0x61c 0x7303 0x92fe 0x64d 0x7491 0x92cb 0x64d 0x761f 0x9299 0x64d 0x77ad 0x9273 0x64d 0x793b 0x924d 0x64b 0x7ac8 0x922f 0x65f 0x7c56 0x920e 0x66b 0x7de4 0x91e7 0x657 0x7f72 0x91ba 0x639 0x8100 0x917f 0x619 0x828e 0x9140 0x625 0x841c 0x9109 0x62d 0x85aa 0x90cd 0x616 0x8737 0x9085 0x5f7 0x88c5 0x904c 0x61f 0x8a53 0x902d 0x65e 0x8be1 0x9028 0x69e 0x8d6f 0x901e 0x6a9 0x8efd 0x9007 0x6a9 0x908b 0x8fed 0x6a9 0x9219 0x8f91 0x639 0x93a6 0x8e75 0x447 0x9534 0x8cc5 0x2a2 0x96c2 0x8a88 0x180 0x9850 0x88b2 0x28c 0x99de 0x8472 0x1db>;
		battery2_profile_t1_num = <0x64>;
		battery2_profile_t1 = <0x00 0xaa57 0x5ff 0x18e 0xa9c5 0x5ff 0x31c 0xa93a 0x60d 0x4aa 0xa8af 0x5fe 0x638 0xa831 0x60e 0x7c5 0xa7b3 0x610 0x953 0xa73c 0x621 0xae1 0xa6c4 0x62e 0xc6f 0xa651 0x62c 0xdfd 0xa5d9 0x62c 0xf8b 0xa564 0x635 0x1119 0xa4f5 0x649 0x12a7 0xa47e 0x63c 0x1434 0xa40d 0x63d 0x15c2 0xa39b 0x640 0x1750 0xa32d 0x656 0x18de 0xa2c3 0x666 0x1a6c 0xa254 0x661 0x1bfa 0xa1e8 0x670 0x1d88 0xa17d 0x67a 0x1f16 0xa111 0x67b 0x20a3 0xa0a5 0x681 0x2231 0xa03d 0x692 0x23bf 0x9fd5 0x6a1 0x254d 0x9f6f 0x6b0 0x26db 0x9f20 0x6e7 0x2869 0x9ee4 0x73d 0x29f7 0x9e93 0x738 0x2b85 0x9e15 0x6ce 0x2d12 0x9d79 0x66c 0x2ea0 0x9ce4 0x669 0x302e 0x9c68 0x6b4 0x31bc 0x9c0e 0x700 0x334a 0x9bcf 0x769 0x34d8 0x9b9e 0x792 0x3666 0x9b69 0x79c 0x37f4 0x9b22 0x789 0x3982 0x9adb 0x78d 0x3b0f 0x9a8d 0x792 0x3c9d 0x9a3f 0x79d 0x3e2b 0x99ee 0x7a3 0x3fb9 0x9997 0x795 0x4147 0x9939 0x778 0x42d5 0x98c4 0x73d 0x4463 0x984c 0x6f0 0x45f1 0x97da 0x6af 0x477e 0x977f 0x6a9 0x490c 0x972c 0x69b 0x4a9a 0x96e6 0x6a9 0x4c28 0x96a7 0x6a9 0x4db6 0x966e 0x6b8 0x4f44 0x963b 0x6ba 0x50d2 0x9603 0x6ab 0x5260 0x95d6 0x6c7 0x53ed 0x95aa 0x6c7 0x557b 0x957e 0x6cb 0x5709 0x9552 0x6d6 0x5897 0x952c 0x6db 0x5a25 0x9507 0x6e8 0x5bb3 0x94e2 0x6ee 0x5d41 0x94c2 0x708 0x5ecf 0x94a3 0x70b 0x605c 0x9481 0x713 0x61ea 0x945e 0x70e 0x6378 0x9446 0x72a 0x6506 0x942c 0x73a 0x6694 0x9413 0x744 0x6822 0x93f9 0x74f 0x69b0 0x93e0 0x75d 0x6b3e 0x93c7 0x756 0x6ccc 0x93ae 0x754 0x6e59 0x9392 0x746 0x6fe7 0x9375 0x73c 0x7175 0x9350 0x720 0x7303 0x932a 0x70f 0x7491 0x930a 0x70f 0x761f 0x92e7 0x701 0x77ad 0x92bd 0x6e5 0x793b 0x9292 0x6db 0x7ac8 0x9273 0x6f0 0x7c56 0x9256 0x6f6 0x7de4 0x9236 0x6f6 0x7f72 0x920a 0x6ed 0x8100 0x91d8 0x6dd 0x828e 0x919d 0x6b7 0x841c 0x9162 0x6cb 0x85aa 0x9132 0x6ef 0x8737 0x90f2 0x6d3 0x88c5 0x909e 0x6a2 0x8a53 0x905f 0x6cb 0x8be1 0x9044 0x724 0x8d6f 0x9037 0x742 0x8efd 0x902f 0x75e 0x908b 0x901e 0x764 0x9219 0x900b 0x77f 0x93a6 0x8fbf 0x72d 0x9534 0x8ed0 0x59e 0x96c2 0x8d14 0x388 0x9850 0x8ad4 0x245 0x99de 0x87c7 0x7d>;
		battery2_profile_t2_num = <0x64>;
		battery2_profile_t2 = <0x00 0xaa4a 0xbbf 0x18e 0xa9bf 0xbbf 0x31c 0xa92e 0xbbe 0x4aa 0xa8a9 0xbce 0x638 0xa82b 0xbce 0x7c5 0xa7ad 0xbd0 0x953 0xa736 0xbde 0xae1 0xa6c9 0xbde 0xc6f 0xa651 0xbdb 0xdfd 0xa5da 0xbcf 0xf8b 0xa568 0xbce 0x1119 0xa4f6 0xbcf 0x12a7 0xa485 0xbcf 0x1434 0xa416 0xbd2 0x15c2 0xa3ad 0xbde 0x1750 0xa33d 0xbde 0x18de 0xa2d4 0xbe5 0x1a6c 0xa26d 0xbf4 0x1bfa 0xa1ff 0xbf9 0x1d88 0xa18f 0xbf5 0x1f16 0xa126 0xc04 0x20a3 0xa0be 0xc0d 0x2231 0xa053 0xc14 0x23bf 0x9ff0 0xc2a 0x254d 0x9f97 0xc4a 0x26db 0x9f52 0xc91 0x2869 0x9f1c 0xcdf 0x29f7 0x9ec4 0xcd3 0x2b85 0x9e36 0xc5f 0x2d12 0x9d8b 0xbef 0x2ea0 0x9ce9 0xbe2 0x302e 0x9c60 0xc0b 0x31bc 0x9bf2 0xc44 0x334a 0x9b9d 0xc82 0x34d8 0x9b59 0xcb7 0x3666 0x9b28 0xcf2 0x37f4 0x9afb 0xd1a 0x3982 0x9ac1 0xd17 0x3b0f 0x9a78 0xcfc 0x3c9d 0x9a27 0xcdc 0x3e2b 0x99d1 0xccb 0x3fb9 0x996d 0xc93 0x4147 0x9903 0xc55 0x42d5 0x989d 0xc22 0x4463 0x9838 0xc01 0x45f1 0x97de 0xbd3 0x477e 0x9785 0xb23 0x490c 0x9732 0xb13 0x4a9a 0x96f2 0xb22 0x4c28 0x96b3 0xaf5 0x4db6 0x967a 0xa9a 0x4f44 0x9642 0xa4a 0x50d2 0x9614 0xa27 0x5260 0x95dd 0x9ed 0x53ed 0x95b1 0x9df 0x557b 0x958a 0x9dc 0x5709 0x955f 0x9c1 0x5897 0x9538 0x9bf 0x5a25 0x9513 0x9bc 0x5bb3 0x94ed 0x9ad 0x5d41 0x94c8 0x9a1 0x5ecf 0x94a9 0x9a1 0x605c 0x948b 0x9a5 0x61ea 0x9470 0x9b0 0x6378 0x9452 0x9b0 0x6506 0x9436 0x9ab 0x6694 0x9419 0x9a1 0x6822 0x9400 0x9a1 0x69b0 0x93e7 0x9a7 0x6b3e 0x93d0 0x9b6 0x6ccc 0x93ba 0x9b9 0x6e59 0x939b 0x9a3 0x6fe7 0x9375 0x983 0x7175 0x934d 0x95c 0x7303 0x9323 0x943 0x7491 0x92fa 0x93c 0x761f 0x92d1 0x92d 0x77ad 0x92ab 0x927 0x793b 0x9285 0x925 0x7ac8 0x925f 0x924 0x7c56 0x923d 0x92d 0x7de4 0x921d 0x93e 0x7f72 0x91fa 0x93b 0x8100 0x91cb 0x920 0x828e 0x9194 0x909 0x841c 0x915c 0x905 0x85aa 0x9123 0x906 0x8737 0x90ee 0x911 0x88c5 0x90a4 0x8e6 0x8a53 0x9056 0x8e3 0x8be1 0x9033 0x93d 0x8d6f 0x9024 0x96c 0x8efd 0x9018 0x981 0x908b 0x900b 0x981 0x9219 0x8ff9 0x99e 0x93a6 0x8fcf 0x983 0x9534 0x8f34 0x88a 0x96c2 0x8dbf 0x655 0x9850 0x86e8 0x50e 0x99de 0x84d0 0x382>;
		battery2_profile_t3_num = <0x64>;
		battery2_profile_t3 = <0x00 0xaa44 0xe2b 0x18e 0xa9a0 0xe2c 0x31c 0xa909 0xe4a 0x4aa 0xa87e 0xe5c 0x638 0xa800 0xe6a 0x7c5 0xa782 0xe67 0x953 0xa70a 0xe4b 0xae1 0xa698 0xe5b 0xc6f 0xa626 0xe67 0xdfd 0xa5af 0xe56 0xf8b 0xa53d 0xe49 0x1119 0xa4cb 0xe46 0x12a7 0xa45b 0xe3b 0x1434 0xa3f1 0xe3f 0x15c2 0xa388 0xe4b 0x1750 0xa31a 0xe4f 0x18de 0xa2b1 0xe55 0x1a6c 0xa243 0xe50 0x1bfa 0xa1dc 0xe60 0x1d88 0xa170 0xe6a 0x1f16 0xa107 0xe70 0x20a3 0xa09f 0xe80 0x2231 0xa037 0xe90 0x23bf 0x9fdd 0xea6 0x254d 0x9f97 0xedd 0x26db 0x9f5b 0xf2c 0x2869 0x9f11 0xf62 0x29f7 0x9e9b 0xf36 0x2b85 0x9df1 0xead 0x2d12 0x9d33 0xe3d 0x2ea0 0x9c8c 0xe2f 0x302e 0x9c07 0xe58 0x31bc 0x9b9f 0xe7d 0x334a 0x9b48 0xea6 0x34d8 0x9afe 0xec1 0x3666 0x9ac1 0xee6 0x37f4 0x9a92 0xf0b 0x3982 0x9a5c 0xf1f 0x3b0f 0x9a15 0xf00 0x3c9d 0x99c4 0xed1 0x3e2b 0x9968 0xea0 0x3fb9 0x9904 0xe57 0x4147 0x98a9 0xe30 0x42d5 0x984b 0xe02 0x4463 0x97f2 0xdef 0x45f1 0x979f 0xdd2 0x477e 0x9752 0xdcd 0x490c 0x9707 0xdb0 0x4a9a 0x96c7 0xdbf 0x4c28 0x9688 0xdaf 0x4db6 0x964e 0xdaf 0x4f44 0x9616 0xdbe 0x50d2 0x95e9 0xdd0 0x5260 0x95b7 0xddf 0x53ed 0x958b 0xdef 0x557b 0x9560 0xe02 0x5709 0x9539 0xe1c 0x5897 0x9514 0xe2e 0x5a25 0x94f3 0xe3b 0x5bb3 0x94c9 0xe41 0x5d41 0x94ab 0xe5e 0x5ecf 0x9490 0xe6d 0x605c 0x946f 0xe75 0x61ea 0x944c 0xe6e 0x6378 0x9433 0xe82 0x6506 0x941b 0xea1 0x6694 0x9407 0xeb8 0x6822 0x93ef 0xebd 0x69b0 0x93df 0xed3 0x6b3e 0x93d2 0xeec 0x6ccc 0x93c3 0xefb 0x6e59 0x93b2 0xf0c 0x6fe7 0x93a6 0xf1b 0x7175 0x9399 0xf2b 0x7303 0x938a 0xf3c 0x7491 0x9376 0xf4a 0x761f 0x9360 0xf63 0x77ad 0x9344 0xf73 0x793b 0x9320 0xf72 0x7ac8 0x92fe 0xf82 0x7c56 0x92da 0xfa3 0x7de4 0x92b4 0xfcd 0x7f72 0x9286 0xfe7 0x8100 0x924f 0x100b 0x828e 0x9217 0x1046 0x841c 0x91da 0x1086 0x85aa 0x919f 0x10dc 0x8737 0x915c 0x1118 0x88c5 0x910d 0x1160 0x8a53 0x90c5 0x11d3 0x8be1 0x9099 0x1279 0x8d6f 0x907d 0x1333 0x8efd 0x9069 0x13f0 0x908b 0x9050 0x14ad 0x9219 0x9026 0x1587 0x93a6 0x8fe3 0x1675 0x9534 0x8f2a 0x1727 0x96c2 0x8dad 0x169d 0x9850 0x86e7 0x1688 0x99de 0x84d0 0x16e4>;
		battery2_profile_t4_num = <0x64>;
		battery2_profile_t4 = <0x00 0xaa5d 0x1c0a 0x18e 0xa9b9 0x1c0b 0x31c 0xa921 0x1c67 0x4aa 0xa890 0x1c75 0x638 0xa80c 0x1c75 0x7c5 0xa793 0x1c72 0x953 0xa716 0x1c53 0xae1 0xa69e 0x1c43 0xc6f 0xa627 0x1c23 0xdfd 0xa5b4 0x1c06 0xf8b 0xa53d 0x1bf2 0x1119 0xa4cb 0x1bd3 0x12a7 0xa45b 0x1bb8 0x1434 0xa3ef 0x1ba8 0x15c2 0xa382 0x1b93 0x1750 0xa314 0x1b7e 0x18de 0xa2ad 0x1b7e 0x1a6c 0xa23f 0x1b73 0x1bfa 0xa1cf 0x1b59 0x1d88 0xa164 0x1b4f 0x1f16 0xa0f8 0x1b43 0x20a3 0xa08c 0x1b2a 0x2231 0xa02f 0x1b21 0x23bf 0x9fe0 0x1b36 0x254d 0x9f94 0x1b75 0x26db 0x9f42 0x1bad 0x2869 0x9ed6 0x1ba3 0x29f7 0x9e46 0x1b42 0x2b85 0x9d94 0x1aa1 0x2d12 0x9cd6 0x1a06 0x2ea0 0x9c2b 0x199e 0x302e 0x9b98 0x1962 0x31bc 0x9b1d 0x195a 0x334a 0x9ab8 0x196b 0x34d8 0x9a5d 0x196f 0x3666 0x9a12 0x1985 0x37f4 0x99cc 0x1998 0x3982 0x998b 0x199b 0x3b0f 0x9942 0x19a8 0x3c9d 0x98fb 0x1995 0x3e2b 0x98ac 0x1980 0x3fb9 0x985f 0x1958 0x4147 0x9812 0x194e 0x42d5 0x97c7 0x1933 0x4463 0x977b 0x1932 0x45f1 0x973b 0x1940 0x477e 0x96fb 0x194f 0x490c 0x96b5 0x193f 0x4a9a 0x967d 0x195e 0x4c28 0x963e 0x1970 0x4db6 0x960a 0x197d 0x4f44 0x95d8 0x19ae 0x50d2 0x95a6 0x19dc 0x5260 0x9579 0x19dd 0x53ed 0x954c 0x1a0c 0x557b 0x951b 0x1a2b 0x5709 0x94f6 0x1a4d 0x5897 0x94d5 0x1a7c 0x5a25 0x94b1 0x1aac 0x5bb3 0x9490 0x1ad6 0x5d41 0x946b 0x1af0 0x5ecf 0x944d 0x1b28 0x605c 0x9434 0x1b47 0x61ea 0x941e 0x1b6f 0x6378 0x940f 0x1bb0 0x6506 0x93fc 0x1be4 0x6694 0x93ec 0x1c13 0x6822 0x93df 0x1c5c 0x69b0 0x93d0 0x1ca3 0x6b3e 0x93bf 0x1cde 0x6ccc 0x93b3 0x1d18 0x6e59 0x93a6 0x1d7d 0x6fe7 0x9396 0x1de4 0x7175 0x9383 0x1e44 0x7303 0x9371 0x1ec2 0x7491 0x9357 0x1f50 0x761f 0x933b 0x1fd6 0x77ad 0x931e 0x2075 0x793b 0x92fe 0x2123 0x7ac8 0x92df 0x21ed 0x7c56 0x92b8 0x22c1 0x7de4 0x928c 0x23a5 0x7f72 0x925b 0x2491 0x8100 0x9224 0x257d 0x828e 0x91ef 0x267f 0x841c 0x91b9 0x27af 0x85aa 0x9176 0x28ea 0x8737 0x9135 0x2a31 0x88c5 0x90f6 0x2ba2 0x8a53 0x90c1 0x2d5c 0x8be1 0x9093 0x2f4c 0x8d6f 0x9071 0x3179 0x8efd 0x9047 0x33e9 0x908b 0x901b 0x36b4 0x9219 0x8fde 0x399a 0x93a6 0x8f66 0x3c4a 0x9534 0x8e84 0x3df7 0x96c2 0x8d2f 0x3efd 0x9850 0x8b54 0x3fa1 0x99de 0x89bd 0x420e>;
		linux,phandle = <0x73>;
		phandle = <0x73>;
	};

	topmisc@10011000 {
		compatible = "mediatek,topmisc";
		reg = <0x00 0x10011000 0x00 0x1000>;
	};

	dvfsrc@10012000 {
		compatible = "mediatek,dvfsrc";
		reg = <0x00 0x10012000 0x00 0x1000 0x00 0x110780 0x00 0x80>;
	};

	mbist_ao@10013000 {
		compatible = "mediatek,mbist_ao";
		reg = <0x00 0x10013000 0x00 0x1000>;
	};

	apcldmain_ao@10014000 {
		compatible = "mediatek,apcldmain_ao";
		reg = <0x00 0x10014000 0x00 0x400>;
	};

	apcldmaout_ao@10014400 {
		compatible = "mediatek,apcldmaout_ao";
		reg = <0x00 0x10014400 0x00 0x400>;
	};

	apcldmamisc_ao@10014800 {
		compatible = "mediatek,apcldmamisc_ao";
		reg = <0x00 0x10014800 0x00 0x400>;
	};

	apcldmamisc_ao@10014c00 {
		compatible = "mediatek,apcldmamisc_ao";
		reg = <0x00 0x10014c00 0x00 0x400>;
	};

	aes_top0@10016000 {
		compatible = "mediatek,aes_top0";
		reg = <0x00 0x10016000 0x00 0x1000>;
	};

	sys_timer@10017000 {
		compatible = "mediatek,sys_timer";
		reg = <0x00 0x10017000 0x00 0x1000>;
		reg-names = "sys_timer_base";
		interrupts = <0x00 0x8a 0x04>;
	};

	modem_temp_share@10018000 {
		compatible = "mediatek,modem_temp_share";
		reg = <0x00 0x10018000 0x00 0x1000>;
	};

	security_ao@1001a000 {
		compatible = "mediatek,security_ao";
		reg = <0x00 0x1001a000 0x00 0x1000>;
	};

	topckgen_ao@1001b000 {
		compatible = "mediatek,topckgen_ao";
		reg = <0x00 0x1001b000 0x00 0x1000>;
	};

	iocfg_0@10002000 {
		compatible = "mediatek,iocfg_0";
		reg = <0x00 0x10002000 0x00 0x200>;
	};

	iocfg_1@10002200 {
		compatible = "mediatek,iocfg_1";
		reg = <0x00 0x10002200 0x00 0x200>;
	};

	iocfg_2@10002400 {
		compatible = "mediatek,iocfg_2";
		reg = <0x00 0x10002400 0x00 0x200>;
	};

	iocfg_3@10002600 {
		compatible = "mediatek,iocfg_3";
		reg = <0x00 0x10002600 0x00 0x200>;
	};

	iocfg_4@10002800 {
		compatible = "mediatek,iocfg_4";
		reg = <0x00 0x10002800 0x00 0x200>;
	};

	iocfg_5@10002a00 {
		compatible = "mediatek,iocfg_5";
		reg = <0x00 0x10002a00 0x00 0x200>;
	};

	mdcldmain_ao@10015000 {
		compatible = "mediatek,mdcldmain_ao";
		reg = <0x00 0x10015000 0x00 0x400>;
	};

	mdcldmaout_ao@10015400 {
		compatible = "mediatek,mdcldmaout_ao";
		reg = <0x00 0x10015400 0x00 0x400>;
	};

	mdcldmamisc_ao@10015800 {
		compatible = "mediatek,mdcldmamisc_ao";
		reg = <0x00 0x10015800 0x00 0x400>;
	};

	sys_cirq@10204000 {
		compatible = "mediatek,sys_cirq";
		reg = <0x00 0x10204000 0x00 0x1000>;
		mediatek,cirq_num = <0xd1>;
		mediatek,spi_start_offset = <0x10>;
		interrupts = <0x00 0xe0 0x08>;
	};

	mcucfg@10200000 {
		compatible = "mediatek,mcucfg";
		reg = <0x00 0x10200000 0x00 0x200>;
		interrupts = <0x00 0x00 0x04>;
	};

	mcucfg@10200200 {
		compatible = "mediatek,mcucfg";
		reg = <0x00 0x10200200 0x00 0x200>;
		interrupts = <0x00 0x01 0x08>;
	};

	mcucfg@10200400 {
		compatible = "mediatek,mcucfg";
		reg = <0x00 0x10200400 0x00 0x200>;
		interrupts = <0x00 0x02 0x04>;
	};

	mcucfg@10200600 {
		compatible = "mediatek,mcucfg";
		reg = <0x00 0x10200600 0x00 0x200>;
		interrupts = <0x00 0x03 0x04>;
	};

	mcucfg@10200800 {
		compatible = "mediatek,mcucfg";
		reg = <0x00 0x10200800 0x00 0x200>;
		interrupts = <0x00 0x04 0x04>;
	};

	mcucfg@10200a00 {
		compatible = "mediatek,mcucfg";
		reg = <0x00 0x10200a00 0x00 0x300>;
		interrupts = <0x00 0x05 0x08>;
	};

	mcucfg@10200f00 {
		compatible = "mediatek,mcucfg";
		reg = <0x00 0x10200f00 0x00 0x100>;
		interrupts = <0x00 0x06 0x08>;
	};

	mcucfg@10201000 {
		compatible = "mediatek,mcucfg";
		reg = <0x00 0x10201000 0x00 0x1000>;
		interrupts = <0x00 0x07 0x08>;
	};

	mcucfg@10202000 {
		compatible = "mediatek,mcucfg";
		reg = <0x00 0x10202000 0x00 0x1000>;
		interrupts = <0x00 0x08 0x08>;
	};

	mcucfg@10203000 {
		compatible = "mediatek,mcucfg";
		reg = <0x00 0x10203000 0x00 0x1000>;
		interrupts = <0x00 0x09 0x08>;
	};

	mcucfg_mp0_counter@10200000 {
		compatible = "mediatek,mcucfg_mp0_counter";
		reg = <0x00 0x10200000 0x00 0x4000>;
	};

	m4u@10205000 {
		cell-index = <0x00>;
		compatible = "mediatek,iommu_v0";
		reg = <0x00 0x10205000 0x00 0x1000>;
		mediatek,larbs = <0x1c 0x1d 0x1e>;
		interrupts = <0x00 0x9e 0x08>;
		#iommu-cells = <0x01>;
		linux,phandle = <0x44>;
		phandle = <0x44>;
	};

	devapc@10207000 {
		compatible = "mediatek,devapc";
		reg = <0x00 0x10207000 0x00 0x1000>;
		interrupts = <0x00 0x56 0x08>;
		clocks = <0x1f 0x28>;
		clock-names = "devapc-infra-clock";
	};

	bus_dbg@10208000 {
		compatible = "mediatek,bus_dbg-v2";
		reg = <0x00 0x10208000 0x00 0x1000 0x00 0x10001000 0x00 0x1000>;
		mediatek,bus_dbg_con_offset = <0x2fc>;
		interrupts = <0x00 0x55 0x08>;
	};

	ap_ccif0@10209000 {
		compatible = "mediatek,ap_ccif0";
		reg = <0x00 0x10209000 0x00 0x1000>;
		interrupts = <0x00 0x5c 0x08>;
	};

	md_ccif0@1020a000 {
		compatible = "mediatek,md_ccif0";
		reg = <0x00 0x1020a000 0x00 0x1000>;
	};

	ap_ccif1@1020b000 {
		compatible = "mediatek,ap_ccif1";
		reg = <0x00 0x1020b000 0x00 0x1000>;
		interrupts = <0x00 0x5e 0x08>;
	};

	md_ccif1@1020c000 {
		compatible = "mediatek,md_ccif1";
		reg = <0x00 0x1020c000 0x00 0x1000>;
	};

	infra_mbist@1020d000 {
		compatible = "mediatek,infra_mbist";
		reg = <0x00 0x1020d000 0x00 0x1000>;
	};

	infracfg@1020e000 {
		compatible = "mediatek,infracfg";
		reg = <0x00 0x1020e000 0x00 0x1000>;
	};

	trng@1020f000 {
		compatible = "mediatek,trng";
		reg = <0x00 0x1020f000 0x00 0x1000>;
		interrupts = <0x00 0x69 0x08>;
	};

	dxcc_sec@10210000 {
		compatible = "mediatek,dxcc_sec";
		reg = <0x00 0x10210000 0x00 0x1000>;
		interrupts = <0x00 0x6a 0x04>;
	};

	mcupm_sram2@10211000 {
		compatible = "mediatek,mcupm_sram2";
		reg = <0x00 0x10211000 0x00 0x1000>;
	};

	cq_dma@10212000 {
		compatible = "mediatek,mt-cqdma-v1";
		reg = <0x00 0x10212000 0x00 0x80 0x00 0x10212080 0x00 0x80 0x00 0x10212100 0x00 0x68>;
		interrupts = <0x00 0x39 0x08 0x00 0x3a 0x08 0x00 0x3b 0x08>;
		nr_channel = <0x03>;
		keep_clock_ao = "yes";
		clocks = <0x1f 0x43>;
		clock-names = "cqdma";
	};

	mcupm_sram3@10213000 {
		compatible = "mediatek,mcupm_sram3";
		reg = <0x00 0x10213000 0x00 0x1000>;
	};

	sramrom@10214000 {
		compatible = "mediatek,sramrom";
		reg = <0x00 0x10214000 0x00 0x1000>;
	};

	mcupm_reg@10216000 {
		compatible = "mediatek,mcupm_reg";
		reg = <0x00 0x10216000 0x00 0x1000>;
	};

	mcupm_sram0@10217000 {
		compatible = "mediatek,mcupm_sram0";
		reg = <0x00 0x10217000 0x00 0x1000>;
	};

	mcupm_sram1@10218000 {
		compatible = "mediatek,mcupm_sram1";
		reg = <0x00 0x10218000 0x00 0x1000>;
	};

	emi@10219000 {
		compatible = "mediatek,emi";
		reg = <0x00 0x10219000 0x00 0x1000 0x00 0x10226000 0x00 0x1000 0x00 0x1022d000 0x00 0x1000 0x00 0x10235000 0x00 0x1000>;
		interrupts = <0x00 0x58 0x08>;
	};

	apcldmain@1021b000 {
		compatible = "mediatek,apcldmain";
		reg = <0x00 0x1021b000 0x00 0x100>;
	};

	apcldmaout@1021b400 {
		compatible = "mediatek,apcldmaout";
		reg = <0x00 0x1021b400 0x00 0x100>;
	};

	apcldmamisc@1021b800 {
		compatible = "mediatek,apcldmamisc";
		reg = <0x00 0x1021b800 0x00 0x100>;
		interrupts = <0x00 0x6d 0x04>;
	};

	mdcldmain@1021c000 {
		compatible = "mediatek,mdcldmain";
		reg = <0x00 0x1021c000 0x00 0x400>;
	};

	mdcldmaout@1021c400 {
		compatible = "mediatek,mdcldmaout";
		reg = <0x00 0x1021c400 0x00 0x400>;
	};

	mdcldmamisc@1021c800 {
		compatible = "mediatek,mdcldmamisc";
		reg = <0x00 0x1021c800 0x00 0x1000>;
	};

	mdcldma@10014000 {
		compatible = "mediatek,mdcldma";
		reg = <0x00 0x10014000 0x00 0x1000 0x00 0x1021b000 0x00 0x1000 0x00 0x10209000 0x00 0x1000 0x00 0x1020a000 0x00 0x1000>;
		interrupts = <0x00 0x6d 0x04 0x00 0x5c 0x08 0x00 0x5d 0x08 0x00 0xcd 0x02>;
		mediatek,md_id = <0x00>;
		mediatek,cldma_capability = <0x06>;
		clocks = <0x20 0x00 0x1f 0x32 0x1f 0x29 0x1f 0x2c 0x1f 0x23 0x1f 0x24 0x1f 0x58 0x1f 0x59>;
		clock-names = "scp-sys-md1-main\0infra-cldma-bclk\0infra-ccif-ap\0infra-ccif-md\0infra-ccif1-ap\0infra-ccif1-md\0infra-ccif2-ap\0infra-ccif2-md";
		linux,phandle = <0x10>;
		phandle = <0x10>;
	};

	bpi_bsi_slv0@1021e000 {
		compatible = "mediatek,bpi_bsi_slv0";
		reg = <0x00 0x1021e000 0x00 0x1000>;
	};

	bpi_bsi_slv1@1021f000 {
		compatible = "mediatek,bpi_bsi_slv1";
		reg = <0x00 0x1021f000 0x00 0x6000>;
	};

	bpi_bsi_slv2@10225000 {
		compatible = "mediatek,bpi_bsi_slv2";
		reg = <0x00 0x10225000 0x00 0x1000>;
	};

	dvfsp@10227000 {
		compatible = "mediatek,dvfsp";
		reg = <0x00 0x10227000 0x00 0x1000>;
	};

	dvfsp@00110800 {
		compatible = "mediatek,mt6761-dvfsp";
		reg = <0x00 0x110800 0x00 0x1400 0x00 0x110800 0x00 0x1400>;
	};

	dramc@1022a000 {
		compatible = "mediatek,dramc";
		reg = <0x00 0x1022a000 0x00 0x2000 0x00 0x10232000 0x00 0x2000 0x00 0x1022c000 0x00 0x1000 0x00 0x10234000 0x00 0x1000 0x00 0x10228000 0x00 0x2000 0x00 0x10230000 0x00 0x2000 0x00 0x1022e000 0x00 0x1000 0x00 0x10236000 0x00 0x1000>;
	};

	gce@10238000 {
		compatible = "mediatek,gce\0syscon";
		reg = <0x00 0x10238000 0x00 0x4000>;
		#clock-cells = <0x01>;
		interrupts = <0x00 0x62 0x08>;
		g3d_config_base = <0x13000000 0x00 0xffff0000>;
		mmsys_config_base = <0x14000000 0x01 0xffff0000>;
		disp_dither_base = <0x14010000 0x02 0xffff0000>;
		mm_na_base = <0x14020000 0x03 0xffff0000>;
		imgsys_base = <0x15020000 0x04 0xffff0000>;
		vdec_gcon_base = <0x18800000 0x05 0xffff0000>;
		venc_gcon_base = <0x18810000 0x06 0xffff0000>;
		conn_peri_base = <0x18820000 0x07 0xffff0000>;
		topckgen_base = <0x18830000 0x08 0xffff0000>;
		kp_base = <0x18840000 0x09 0xffff0000>;
		scp_sram_base = <0x10000000 0x0a 0xffff0000>;
		infra_na3_base = <0x10010000 0x0b 0xffff0000>;
		infra_na4_base = <0x10020000 0x0c 0xffff0000>;
		scp_base = <0x10030000 0x0d 0xffff0000>;
		mcucfg_base = <0x10040000 0x0e 0xffff0000>;
		gcpu_base = <0x10050000 0x0f 0xffff0000>;
		usb0_base = <0x10200000 0x10 0xffff0000>;
		usb_sif_base = <0x10280000 0x11 0xffff0000>;
		audio_base = <0x17000000 0x12 0xffff0000>;
		vdec_base = <0x17010000 0x13 0xffff0000>;
		msdc2_base = <0x17020000 0x14 0xffff0000>;
		vdec1_base = <0x17030000 0x15 0xffff0000>;
		msdc3_base = <0x18000000 0x16 0xffff0000>;
		ap_dma_base = <0x18010000 0x17 0xffff0000>;
		gce_base = <0x18020000 0x18 0xffff0000>;
		vdec2_base = <0x18040000 0x19 0xffff0000>;
		vdec3_base = <0x18050000 0x1a 0xffff0000>;
		camsys_base = <0x18080000 0x1b 0xffff0000>;
		camsys1_base = <0x180a0000 0x1c 0xffff0000>;
		camsys2_base = <0x180b0000 0x1d 0xffff0000>;
		pwm_sw_base = <0x1100e000 0x63 0xffff0000>;
		mipitx0_base = <0x11c80000 0x63 0xffff0000>;
		mdp_rdma0_sof = <0x00>;
		mdp_ccorr0_sof = <0x01>;
		mdp_rsz0_sof = <0x02>;
		mdp_rsz1_sof = <0x03>;
		mdp_wdma_sof = <0x04>;
		mdp_wrot0_sof = <0x05>;
		mdp_tdshp0_sof = <0x06>;
		disp_ovl0_sof = <0x07>;
		disp_2l_ovl0_sof = <0x08>;
		disp_rdma0_sof = <0x09>;
		disp_wdma0_sof = <0x0a>;
		disp_color0_sof = <0x0b>;
		disp_ccorr0_sof = <0x0c>;
		disp_aal0_sof = <0x0d>;
		disp_gamma0_sof = <0x0e>;
		disp_dither0_sof = <0x0f>;
		disp_dsi0_sof = <0x10>;
		disp_rsz0_sof = <0x11>;
		img_dl_relay_sof = <0x12>;
		disp_pwm0_sof = <0x13>;
		mdp_rdma0_frame_done = <0x14>;
		mdp_ccorr0_frame_done = <0x15>;
		mdp_rsz0_frame_done = <0x16>;
		mdp_rsz1_frame_done = <0x17>;
		mdp_wrot0_write_frame_done = <0x18>;
		mdp_wdma_frame_done = <0x19>;
		mdp_tdshp0_frame_done = <0x1a>;
		disp_ovl0_frame_done = <0x1b>;
		disp_2l_ovl0_frame_done = <0x1c>;
		disp_rsz0_frame_done = <0x1d>;
		disp_rdma0_frame_done = <0x1e>;
		disp_wdma0_frame_done = <0x1f>;
		disp_color0_frame_done = <0x20>;
		disp_ccorr0_frame_done = <0x21>;
		disp_aal0_frame_done = <0x22>;
		disp_gamma0_frame_done = <0x23>;
		disp_dither0_frame_done = <0x24>;
		disp_dsi0_frame_done = <0x25>;
		stream_done_0 = <0x82>;
		stream_done_1 = <0x83>;
		stream_done_2 = <0x84>;
		stream_done_3 = <0x85>;
		stream_done_4 = <0x86>;
		stream_done_5 = <0x87>;
		stream_done_6 = <0x88>;
		stream_done_7 = <0x89>;
		stream_done_8 = <0x8a>;
		stream_done_9 = <0x8b>;
		buf_underrun_event_0 = <0x8c>;
		dsi0_te_event = <0x8d>;
		dsi0_irq_event = <0x8e>;
		dsi0_done_event = <0x8f>;
		disp_wdma0_rst_done = <0x93>;
		mdp_wdma_rst_done = <0x94>;
		mdp_wrot0_rst_done = <0x95>;
		mdp_rdma0_rst_done = <0x97>;
		disp_ovl0_frame_rst_done_pusle = <0x98>;
		dip_cq_thread2_frame_done = <0x101>;
		dip_cq_thread1_frame_done = <0x102>;
		dip_cq_thread0_frame_done = <0x103>;
		isp_frame_done_p1_1 = <0x104>;
		isp_frame_done_p1_0 = <0x105>;
		camsv_0_pass1_done = <0x106>;
		camsv_1_pass1_done = <0x107>;
		seninf_0_fifo_full = <0x108>;
		seninf_1_fifo_full = <0x109>;
		seninf_2_fifo_full = <0x10a>;
		seninf_3_fifo_full = <0x10b>;
		seninf_4_fifo_full = <0x10c>;
		seninf_5_fifo_full = <0x10d>;
		seninf_6_fifo_full = <0x10e>;
		seninf_7_fifo_full = <0x10f>;
		venc_done = <0x121>;
		jpgenc_done = <0x122>;
		jpgdec_done = <0x123>;
		venc_mb_done = <0x124>;
		venc_128byte_cnt_done = <0x125>;
		max_prefetch_cnt = <0x01>;
		prefetch_size = <0x60>;
		sram_size_cpr_64 = <0x40>;
		mmsys_config = <0x21>;
		mdp_rdma0 = <0x22>;
		mdp_rsz0 = <0x23>;
		mdp_rsz1 = <0x24>;
		mdp_wdma0 = <0x25>;
		mdp_wrot0 = <0x26>;
		mdp_tdshp0 = <0x27>;
		mdp_color0 = <0x28>;
		mdp_ccorr0 = <0x29>;
		mm_mutex = <0x2a>;
		sram_share_cnt = <0x01>;
		sram_share_engine = <0x0a>;
		sram_share_event = <0x2c6>;
		clocks = <0x1f 0x09 0x1f 0x18>;
		clock-names = "GCE\0GCE_TIMER";
		mediatek,mailbox-gce = <0x2b>;
		mboxes = <0x2b 0x00 0x00 0x04 0x2b 0x01 0x00 0x04 0x2b 0x02 0x00 0x05 0x2b 0x03 0x00 0x04 0x2b 0x04 0x00 0x04 0x2b 0x05 0x00 0x04 0x2b 0x06 0xc8 0x03 0x2b 0x07 0xffffffff 0x02 0x2b 0x08 0x00 0x01 0x2b 0x09 0x00 0x01 0x2b 0x0a 0x00 0x01 0x2b 0x0b 0x00 0x01 0x2b 0x0c 0x00 0x01 0x2b 0x0d 0x00 0x01 0x2b 0x0e 0x00 0x01 0x2b 0x0f 0x00 0x01>;
		linux,phandle = <0x74>;
		phandle = <0x74>;
	};

	gce_mbox@10238000 {
		compatible = "mediatek,mailbox-gce";
		reg = <0x00 0x10238000 0x00 0x4000>;
		interrupts = <0x00 0x62 0x08>;
		#mbox-cells = <0x03>;
		#gce-event-cells = <0x01>;
		#gce-subsys-cells = <0x02>;
		clocks = <0x1f 0x09 0x1f 0x18>;
		clock-names = "gce\0GCE_TIMER";
		linux,phandle = <0x2b>;
		phandle = <0x2b>;
	};

	ap_ccif2@1023c000 {
		compatible = "mediatek,ap_ccif2";
		reg = <0x00 0x1023c000 0x00 0x1000>;
		interrupts = <0x00 0x57 0x08>;
	};

	md_ccif2@1023d000 {
		compatible = "mediatek,md_ccif2";
		reg = <0x00 0x1023d000 0x00 0x1000>;
	};

	ap_ccif3@1023e000 {
		compatible = "mediatek,ap_ccif3";
		reg = <0x00 0x1023e000 0x00 0x1000>;
		interrupts = <0x00 0x5a 0x08>;
	};

	md_ccif3@1023f000 {
		compatible = "mediatek,md_ccif3";
		reg = <0x00 0x1023f000 0x00 0x1000>;
	};

	sspm@10440000 {
		compatible = "mediatek,sspm";
		reg = <0x00 0x10440000 0x00 0x10000 0x00 0x10450000 0x00 0x100 0x00 0x10451000 0x00 0x08 0x00 0x10460000 0x00 0x100 0x00 0x10461000 0x00 0x08 0x00 0x10470000 0x00 0x100 0x00 0x10471000 0x00 0x08 0x00 0x10480000 0x00 0x100 0x00 0x10481000 0x00 0x08 0x00 0x10490000 0x00 0x100 0x00 0x10491000 0x00 0x08>;
		reg-names = "cfgreg\0mbox0_base\0mbox0_ctrl\0mbox1_base\0mbox1_ctrl\0mbox2_base\0mbox2_ctrl\0mbox3_base\0mbox3_ctrl\0mbox4_base\0mbox4_ctrl";
		interrupts = <0x00 0x92 0x04 0x00 0x95 0x04 0x00 0x96 0x04 0x00 0x97 0x04 0x00 0x98 0x04 0x00 0x99 0x04>;
		interrupt-names = "ipc\0mbox0\0mbox1\0mbox2\0mbox3\0mbox4";
	};

	gic500@0c000000 {
		compatible = "mediatek,gic500";
		reg = <0x00 0xc000000 0x00 0x400000>;
	};

	gic_cpu@0c400000 {
		compatible = "mediatek,gic_cpu";
		reg = <0x00 0xc400000 0x00 0x40000>;
	};

	dfd@10200b00 {
		compatible = "mediatek,dfd";
		reg = <0x00 0x10200b00 0x00 0x10000>;
		mediatek,enabled = <0x01>;
		mediatek,chain_length = <0x61a8>;
		mediatek,rg_dfd_timeout = <0xa0>;
	};

	dbg_cti@0d020000 {
		compatible = "mediatek,dbg_cti";
		reg = <0x00 0xd020000 0x00 0x10000>;
	};

	dbg_etr@0d030000 {
		compatible = "mediatek,dbg_etr";
		reg = <0x00 0xd030000 0x00 0x10000>;
	};

	dbg_funnel@0d040000 {
		compatible = "mediatek,dbg_funnel";
		reg = <0x00 0xd040000 0x00 0x10000>;
	};

	dbg_dem@0d0a0000 {
		compatible = "mediatek,dbg_dem";
		reg = <0x00 0xd0a0000 0x00 0x10000>;
		interrupts = <0x00 0x54 0x08>;
	};

	dbg_mdsys1@0d0c0000 {
		compatible = "mediatek,dbg_mdsys1";
		reg = <0x00 0xd0c0000 0x00 0x40000>;
	};

	dbg_apmcu_mp0@0d400000 {
		compatible = "mediatek,dbg_apmcu_mp0";
		reg = <0x00 0xd400000 0x00 0x1000>;
	};

	dbg_apmcu_mp0@0d410000 {
		compatible = "mediatek,dbg_apmcu_mp0";
		reg = <0x00 0xd410000 0x00 0x1000>;
	};

	dbg_apmcu_mp0@0d420000 {
		compatible = "mediatek,dbg_apmcu_mp0";
		reg = <0x00 0xd420000 0x00 0x1000>;
	};

	dbg_apmcu_mp0@0d430000 {
		compatible = "mediatek,dbg_apmcu_mp0";
		reg = <0x00 0xd430000 0x00 0x1000>;
	};

	dbg_apmcu_mp0@0d440000 {
		compatible = "mediatek,dbg_apmcu_mp0";
		reg = <0x00 0xd440000 0x00 0x1000>;
	};

	dbg_apmcu_mp0@0d510000 {
		compatible = "mediatek,dbg_apmcu_mp0";
		reg = <0x00 0xd510000 0x00 0x1000>;
	};

	dbg_apmcu_mp0@0d520000 {
		compatible = "mediatek,dbg_apmcu_mp0";
		reg = <0x00 0xd520000 0x00 0x1000>;
	};

	dbg_apmcu_mp0@0d530000 {
		compatible = "mediatek,dbg_apmcu_mp0";
		reg = <0x00 0xd530000 0x00 0x1000>;
	};

	dbg_apmcu_mp0@0d540000 {
		compatible = "mediatek,dbg_apmcu_mp0";
		reg = <0x00 0xd540000 0x00 0x1000>;
	};

	dbg_apmcu_mp0@0d610000 {
		compatible = "mediatek,dbg_apmcu_mp0";
		reg = <0x00 0xd610000 0x00 0x1000>;
	};

	dbg_apmcu_mp0@0d620000 {
		compatible = "mediatek,dbg_apmcu_mp0";
		reg = <0x00 0xd620000 0x00 0x1000>;
	};

	dbg_apmcu_mp0@0d630000 {
		compatible = "mediatek,dbg_apmcu_mp0";
		reg = <0x00 0xd630000 0x00 0x1000>;
	};

	dbg_apmcu_mp0@0d640000 {
		compatible = "mediatek,dbg_apmcu_mp0";
		reg = <0x00 0xd640000 0x00 0x1000>;
	};

	dbg_apmcu_mp0@0d710000 {
		compatible = "mediatek,dbg_apmcu_mp0";
		reg = <0x00 0xd710000 0x00 0x1000>;
	};

	dbg_apmcu_mp0@0d720000 {
		compatible = "mediatek,dbg_apmcu_mp0";
		reg = <0x00 0xd720000 0x00 0x1000>;
	};

	dbg_apmcu_mp0@0d730000 {
		compatible = "mediatek,dbg_apmcu_mp0";
		reg = <0x00 0xd730000 0x00 0x1000>;
	};

	dbg_apmcu_mp0@0d740000 {
		compatible = "mediatek,dbg_apmcu_mp0";
		reg = <0x00 0xd740000 0x00 0x1000>;
	};

	dbg_apmcu_mp1@0d800000 {
		compatible = "mediatek,dbg_apmcu_mp1";
		reg = <0x00 0xd800000 0x00 0x1000>;
	};

	dbg_apmcu_mp1@0d810000 {
		compatible = "mediatek,dbg_apmcu_mp1";
		reg = <0x00 0xd810000 0x00 0x1000>;
	};

	dbg_apmcu_mp1@0d820000 {
		compatible = "mediatek,dbg_apmcu_mp1";
		reg = <0x00 0xd820000 0x00 0x1000>;
	};

	dbg_apmcu_mp1@0d830000 {
		compatible = "mediatek,dbg_apmcu_mp1";
		reg = <0x00 0xd830000 0x00 0x1000>;
	};

	dbg_apmcu_mp1@0d840000 {
		compatible = "mediatek,dbg_apmcu_mp1";
		reg = <0x00 0xd840000 0x00 0x1000>;
	};

	dbg_apmcu_mp1@0d910000 {
		compatible = "mediatek,dbg_apmcu_mp1";
		reg = <0x00 0xd910000 0x00 0x1000>;
	};

	dbg_apmcu_mp1@0d920000 {
		compatible = "mediatek,dbg_apmcu_mp1";
		reg = <0x00 0xd920000 0x00 0x1000>;
	};

	dbg_apmcu_mp1@0d930000 {
		compatible = "mediatek,dbg_apmcu_mp1";
		reg = <0x00 0xd930000 0x00 0x1000>;
	};

	dbg_apmcu_mp1@0d940000 {
		compatible = "mediatek,dbg_apmcu_mp1";
		reg = <0x00 0xd940000 0x00 0x1000>;
	};

	dbg_apmcu_mp1@0da10000 {
		compatible = "mediatek,dbg_apmcu_mp1";
		reg = <0x00 0xda10000 0x00 0x1000>;
	};

	dbg_apmcu_mp1@0da20000 {
		compatible = "mediatek,dbg_apmcu_mp1";
		reg = <0x00 0xda20000 0x00 0x1000>;
	};

	dbg_apmcu_mp1@0da30000 {
		compatible = "mediatek,dbg_apmcu_mp1";
		reg = <0x00 0xda30000 0x00 0x1000>;
	};

	dbg_apmcu_mp1@0da40000 {
		compatible = "mediatek,dbg_apmcu_mp1";
		reg = <0x00 0xda40000 0x00 0x1000>;
	};

	dbg_apmcu_mp1@0db10000 {
		compatible = "mediatek,dbg_apmcu_mp1";
		reg = <0x00 0xdb10000 0x00 0x1000>;
	};

	dbg_apmcu_mp1@0db20000 {
		compatible = "mediatek,dbg_apmcu_mp1";
		reg = <0x00 0xdb20000 0x00 0x1000>;
	};

	dbg_apmcu_mp1@0db30000 {
		compatible = "mediatek,dbg_apmcu_mp1";
		reg = <0x00 0xdb30000 0x00 0x1000>;
	};

	dbg_apmcu_mp1@0db40000 {
		compatible = "mediatek,dbg_apmcu_mp1";
		reg = <0x00 0xdb40000 0x00 0x1000>;
	};

	ap_dma@11000000 {
		compatible = "mediatek,ap_dma";
		reg = <0x00 0x11000000 0x00 0x1000>;
		interrupts = <0x00 0x29 0x08>;
	};

	auxadc@11001000 {
		compatible = "mediatek,auxadc";
		reg = <0x00 0x11001000 0x00 0x1000>;
		interrupts = <0x00 0x14 0x02>;
		clocks = <0x1f 0x21>;
		clock-names = "auxadc-main";
		linux,phandle = <0x75>;
		phandle = <0x75>;
	};

	dma-controller@11000580 {
		compatible = "mediatek,mt6577-uart-dma";
		reg = <0x00 0x11000680 0x00 0x80 0x00 0x11000700 0x00 0x80 0x00 0x11000780 0x00 0x80 0x00 0x11000800 0x00 0x80>;
		interrupts = <0x00 0x35 0x08 0x00 0x36 0x08 0x00 0x37 0x08 0x00 0x3c 0x08>;
		clocks = <0x1f 0x26>;
		clock-names = "apdma";
		#dma-cells = <0x01>;
		linux,phandle = <0x2c>;
		phandle = <0x2c>;
	};

	serial@11020000 {
		compatible = "mediatek,mt6761-uart\0mediatek,mt6577-uart";
		reg = <0x00 0x11002000 0x00 0x1000>;
		interrupts = <0x00 0x23 0x08>;
		clocks = <0x1b 0x1f 0x16>;
		clock-names = "baud\0bus";
		dmas = <0x2c 0x00 0x2c 0x01>;
		dma-names = "tx\0rx";
		linux,phandle = <0x76>;
		phandle = <0x76>;
	};

	serial@11030000 {
		compatible = "mediatek,mt6761-uart\0mediatek,mt6577-uart";
		reg = <0x00 0x11003000 0x00 0x1000>;
		interrupts = <0x00 0x24 0x08>;
		clocks = <0x1b 0x1f 0x17>;
		clock-names = "baud\0bus";
		linux,phandle = <0x77>;
		phandle = <0x77>;
	};

	pwm@11006000 {
		compatible = "mediatek,pwm";
		reg = <0x00 0x11006000 0x00 0x1000>;
		interrupts = <0x00 0x15 0x08>;
		clocks = <0x1f 0x10 0x1f 0x11 0x1f 0x12 0x1f 0x13 0x1f 0x14 0x1f 0x30 0x1f 0x0f 0x1f 0x15>;
		clock-names = "PWM1-main\0PWM2-main\0PWM3-main\0PWM4-main\0PWM5-main\0PWM6-main\0PWM-HCLK-main\0PWM-main";
		linux,phandle = <0x78>;
		phandle = <0x78>;
	};

	i2c_common {
		compatible = "mediatek,i2c_common";
		dma_support = [02];
		idvfs = [01];
		set_dt_div = [01];
		check_max_freq = [01];
		ver = [02];
		set_ltiming = [01];
		ext_time_config = [18 01];
		cnt_constraint = [01];
		linux,phandle = <0x79>;
		phandle = <0x79>;
	};

	i2c0@11007000 {
		compatible = "mediatek,i2c";
		id = <0x00>;
		reg = <0x00 0x11007000 0x00 0x1000 0x00 0x11000080 0x00 0x80>;
		interrupts = <0x00 0x1c 0x08>;
		clocks = <0x1f 0x0b 0x1f 0x26>;
		clock-names = "main\0dma";
		clock-div = <0x05>;
		aed = <0x1a>;
		mediatek,hs_only;
		linux,phandle = <0x7a>;
		phandle = <0x7a>;
	};

	i2c1@11008000 {
		compatible = "mediatek,i2c";
		id = <0x01>;
		reg = <0x00 0x11008000 0x00 0x1000 0x00 0x11000100 0x00 0x80>;
		interrupts = <0x00 0x1d 0x08>;
		clocks = <0x1f 0x0b 0x1f 0x26>;
		clock-names = "main\0dma";
		clock-div = <0x05>;
		aed = <0x1a>;
		mediatek,hs_only;
		linux,phandle = <0x7b>;
		phandle = <0x7b>;
	};

	i2c2@11009000 {
		compatible = "mediatek,i2c";
		id = <0x02>;
		reg = <0x00 0x11009000 0x00 0x1000 0x00 0x11000180 0x00 0x180>;
		interrupts = <0x00 0x1e 0x08>;
		clocks = <0x1f 0x0b 0x1f 0x26>;
		clock-names = "main\0dma";
		clock-div = <0x05>;
		aed = <0x1a>;
		ch_offset_default = <0x100>;
		ch_offset_ccu = <0x200>;
		mediatek,hs_only;
		linux,phandle = <0x7c>;
		phandle = <0x7c>;
	};

	i2c3@1100f000 {
		compatible = "mediatek,i2c";
		id = <0x03>;
		reg = <0x00 0x1100f000 0x00 0x1000 0x00 0x11000300 0x00 0x100>;
		interrupts = <0x00 0x1f 0x08>;
		clocks = <0x1f 0x0b 0x1f 0x26>;
		clock-names = "main\0dma";
		clock-div = <0x05>;
		aed = <0x1a>;
		ch_offset_default = <0x100>;
		mediatek,hs_only;
		linux,phandle = <0x7d>;
		phandle = <0x7d>;
	};

	i2c4@11011000 {
		compatible = "mediatek,i2c";
		id = <0x04>;
		reg = <0x00 0x11011000 0x00 0x1000 0x00 0x11000400 0x00 0x180>;
		interrupts = <0x00 0x20 0x08>;
		clocks = <0x1f 0x0b 0x1f 0x26>;
		clock-names = "main\0dma";
		clock-div = <0x05>;
		aed = <0x1a>;
		ch_offset_default = <0x100>;
		ch_offset_ccu = <0x200>;
		mediatek,hs_only;
		linux,phandle = <0x7e>;
		phandle = <0x7e>;
	};

	i2c5@11016000 {
		compatible = "mediatek,i2c";
		id = <0x05>;
		reg = <0x00 0x11016000 0x00 0x1000 0x00 0x11000580 0x00 0x80>;
		interrupts = <0x00 0x4a 0x08>;
		clocks = <0x1f 0x0b 0x1f 0x26>;
		clock-names = "main\0dma";
		clock-div = <0x05>;
		aed = <0x1a>;
		mediatek,hs_only;
		linux,phandle = <0x7f>;
		phandle = <0x7f>;
	};

	i2c6@1100d000 {
		compatible = "mediatek,i2c";
		id = <0x06>;
		reg = <0x00 0x1100d000 0x00 0x1000 0x00 0x11000600 0x00 0x80>;
		interrupts = <0x00 0x4b 0x08>;
		clocks = <0x1f 0x0b 0x1f 0x26>;
		clock-names = "main\0dma";
		clock-div = <0x05>;
		aed = <0x1a>;
		ch_offset_default = <0x100>;
		ch_offset_ccu = <0x200>;
		mediatek,hs_only;
		linux,phandle = <0x80>;
		phandle = <0x80>;
	};

	i2c7 {
		linux,phandle = <0x81>;
		phandle = <0x81>;
	};

	i2c8 {
		linux,phandle = <0x82>;
		phandle = <0x82>;
	};

	i2c9 {
		linux,phandle = <0x83>;
		phandle = <0x83>;
	};

	spi0@1100a000 {
		compatible = "mediatek,mt6765-spi";
		mediatek,pad-select = <0x00>;
		reg = <0x00 0x1100a000 0x00 0x1000>;
		interrupts = <0x00 0x3e 0x08>;
		clocks = <0x19 0x0d 0x19 0x74 0x1f 0x1b>;
		clock-names = "parent-clk\0sel-clk\0spi-clk";
		linux,phandle = <0x84>;
		phandle = <0x84>;
	};

	therm_ctrl@1100b000 {
		compatible = "mediatek,therm_ctrl";
		reg = <0x00 0x1100b000 0x00 0x1000>;
		interrupts = <0x00 0x16 0x08>;
		clocks = <0x1f 0x0a>;
		clock-names = "therm-main";
	};

	eem_fsm@1100b000 {
		compatible = "mediatek,eem_fsm";
		reg = <0x00 0x1100b000 0x00 0x1000>;
		interrupts = <0x00 0x45 0x08>;
	};

	btif@1100c000 {
		compatible = "mediatek,btif";
		reg = <0x00 0x1100c000 0x00 0x1000 0x00 0x11000880 0x00 0x80 0x00 0x11000900 0x00 0x80>;
		interrupts = <0x00 0x38 0x08 0x00 0x4c 0x08 0x00 0x4d 0x08>;
		clocks = <0x1f 0x1a 0x1f 0x26>;
		clock-names = "btifc\0apdmac";
	};

	consys@18002000 {
		compatible = "mediatek,mt6761-consys";
		#address-cells = <0x02>;
		#size-cells = <0x02>;
		reg = <0x00 0x18002000 0x00 0x1000 0x00 0x10007000 0x00 0x100 0x00 0x10001000 0x00 0x1000 0x00 0x10006000 0x00 0x1000 0x00 0x18007000 0x00 0x1000 0x00 0x180b1000 0x00 0x1000 0x00 0x180a3000 0x00 0x1000 0x00 0x180a5000 0x00 0x800 0x00 0x180c1000 0x00 0x1000 0x00 0x18004000 0x00 0x1000>;
		interrupts = <0x00 0xd3 0x08 0x00 0xd5 0x08 0x00 0xd6 0x01>;
		clocks = <0x20 0x01>;
		clock-names = "conn";
		linux,phandle = <0x0f>;
		phandle = <0x0f>;
	};

	wifi@18000000 {
		compatible = "mediatek,wifi";
		reg = <0x00 0x18000000 0x00 0x100000>;
		interrupts = <0x00 0xd4 0x08>;
	};

	disp_pwm@1100e000 {
		compatible = "mediatek,disp_pwm";
		reg = <0x00 0x1100e000 0x00 0x1000>;
	};

	spi1@11010000 {
		compatible = "mediatek,mt6765-spi";
		mediatek,pad-select = <0x00>;
		reg = <0x00 0x11010000 0x00 0x1000>;
		interrupts = <0x00 0x42 0x08>;
		clocks = <0x19 0x0d 0x19 0x74 0x1f 0x34>;
		clock-names = "parent-clk\0sel-clk\0spi-clk";
		linux,phandle = <0x85>;
		phandle = <0x85>;
	};

	spi2@11012000 {
		compatible = "mediatek,mt6765-spi";
		mediatek,pad-select = <0x00>;
		reg = <0x00 0x11012000 0x00 0x1000>;
		interrupts = <0x00 0x48 0x08>;
		clocks = <0x19 0x0d 0x19 0x74 0x1f 0x37>;
		clock-names = "parent-clk\0sel-clk\0spi-clk";
		linux,phandle = <0x86>;
		phandle = <0x86>;
	};

	spi3@11013000 {
		compatible = "mediatek,mt6765-spi";
		mediatek,pad-select = <0x00>;
		reg = <0x00 0x11013000 0x00 0x1000>;
		interrupts = <0x00 0x49 0x08>;
		clocks = <0x19 0x0d 0x19 0x74 0x1f 0x38>;
		clock-names = "parent-clk\0sel-clk\0spi-clk";
		linux,phandle = <0x87>;
		phandle = <0x87>;
	};

	spi4@11014000 {
		compatible = "mediatek,mt6765-spi";
		mediatek,pad-select = <0x00>;
		reg = <0x00 0x11014000 0x00 0x1000>;
		interrupts = <0x00 0x27 0x08>;
		clocks = <0x19 0x0d 0x19 0x74 0x1f 0x41>;
		clock-names = "parent-clk\0sel-clk\0spi-clk";
		linux,phandle = <0x88>;
		phandle = <0x88>;
	};

	spi5@11015000 {
		compatible = "mediatek,mt6765-spi";
		mediatek,pad-select = <0x00>;
		reg = <0x00 0x11015000 0x00 0x1000>;
		interrupts = <0x00 0x28 0x08>;
		clocks = <0x19 0x0d 0x19 0x74 0x1f 0x42>;
		clock-names = "parent-clk\0sel-clk\0spi-clk";
		linux,phandle = <0x89>;
		phandle = <0x89>;
	};

	imp_iic@11017000 {
		compatible = "mediatek,imp_iic";
		reg = <0x00 0x11017000 0x00 0x1000>;
	};

	nfi@11018000 {
		compatible = "mediatek,nfi";
		reg = <0x00 0x11018000 0x00 0x1000>;
	};

	nfiecc@11019000 {
		compatible = "mediatek,nfiecc";
		reg = <0x00 0x11019000 0x00 0x1000>;
	};

	usb0@11200000 {
		compatible = "mediatek,mt6761-usb20";
		reg = <0x00 0x11200000 0x00 0x10000 0x00 0x11cc0000 0x00 0x10000>;
		interrupts = <0x00 0x11 0x08>;
		mode = <0x02>;
		multipoint = <0x01>;
		num_eps = <0x10>;
		clocks = <0x1f 0x08 0x19 0x7f 0x19 0x23>;
		clock-names = "usb0\0usb0_clk_top_sel\0usb0_clk_univpll3_d4";
	};

	usb_sif@11210000 {
		compatible = "mediatek,usb_sif";
		reg = <0x00 0x11210000 0x00 0x1000>;
	};

	msdc@11230000 {
		compatible = "mediatek,msdc";
		reg = <0x00 0x11230000 0x00 0x10000>;
		interrupts = <0x00 0x17 0x08>;
		index = [00];
		clk_src = [01];
		bus-width = <0x08>;
		max-frequency = <0xbebc200>;
		cap-mmc-highspeed;
		mmc-ddr-1_8v;
		mmc-hs200-1_8v;
		mmc-hs400-1_8v;
		no-sd;
		no-sdio;
		non-removable;
		pinctl = <0x2d>;
		pinctl_hs400 = <0x2e>;
		pinctl_hs200 = <0x2f>;
		register_setting = <0x30>;
		host_function = [00];
		bootable;
		status = "okay";
		vmmc-supply = <0x31>;
		clocks = <0x1f 0x4f 0x1f 0x1c 0x1f 0x45>;
		clock-names = "msdc0-clock\0msdc0-hclock\0msdc0-aes-clock";
		linux,phandle = <0x8a>;
		phandle = <0x8a>;
	};

	msdc@11240000 {
		compatible = "mediatek,msdc";
		reg = <0x00 0x11240000 0x00 0x10000>;
		interrupts = <0x00 0x18 0x08>;
		index = [01];
		clk_src = [02];
		bus-width = <0x04>;
		max-frequency = <0xbebc200>;
		cap-sd-highspeed;
		sd-uhs-sdr12;
		sd-uhs-sdr25;
		sd-uhs-sdr50;
		sd-uhs-sdr104;
		sd-uhs-ddr50;
		no-mmc;
		no-sdio;
		pinctl = <0x32>;
		pinctl_sdr104 = <0x33>;
		pinctl_sdr50 = <0x34>;
		pinctl_ddr50 = <0x35>;
		register_setting = <0x36>;
		host_function = [01];
		cd_level = [00];
		cd-gpios = <0x37 0x00 0x00>;
		status = "okay";
		vmmc-supply = <0x38>;
		vqmmc-supply = <0x39>;
		clocks = <0x1f 0x50 0x1f 0x1d>;
		clock-names = "msdc1-clock\0msdc1-hclock";
		linux,phandle = <0x8b>;
		phandle = <0x8b>;
	};

	msdc@11250000 {
		compatible = "mediatek,msdc2";
		reg = <0x00 0x11250000 0x00 0x10000>;
		status = "disable";
		linux,phandle = <0x8c>;
		phandle = <0x8c>;
	};

	msdc@11260000 {
		compatible = "mediatek,msdc3";
		reg = <0x00 0x11250000 0x00 0x10000>;
		status = "disable";
		linux,phandle = <0x8d>;
		phandle = <0x8d>;
	};

	msdc1_ins@0 {
		compatible = "mediatek,mt6761-sdcard-ins";
		linux,phandle = <0x8e>;
		phandle = <0x8e>;
	};

	msdc0_top@11cd0000 {
		compatible = "mediatek,msdc0_top";
		reg = <0x00 0x11cd0000 0x00 0x1000>;
	};

	msdc1_top@11c90000 {
		compatible = "mediatek,msdc1_top";
		reg = <0x00 0x11c90000 0x00 0x1000>;
	};

	usb1p_sif@11210000 {
		compatible = "mediatek,usb1p_sif";
		reg = <0x00 0x11210000 0x00 0x10000>;
	};

	btcvsd@10001000 {
		compatible = "mediatek,audio_bt_cvsd";
		offset = <0xf00 0x800 0x140 0x144 0x148>;
		reg = <0x00 0x10001000 0x00 0x1000 0x00 0x18050000 0x00 0x1000 0x00 0x18080000 0x00 0x10000>;
		interrupts = <0x00 0xd2 0x08>;
	};

	audio@11220000 {
		compatible = "mediatek,audio\0syscon";
		reg = <0x00 0x11220000 0x00 0x1000>;
		#clock-cells = <0x01>;
		linux,phandle = <0x3a>;
		phandle = <0x3a>;
	};

	mt_soc_dl1_pcm@11220000 {
		compatible = "mediatek,mt_soc_pcm_dl1";
		reg = <0x00 0x11220000 0x00 0x1000>;
		interrupts = <0x00 0x61 0x08>;
		clocks = <0x3a 0x00 0x3a 0x04 0x3a 0x05 0x3a 0x03 0x3a 0x01 0x3a 0x02 0x3a 0x06 0x1f 0x2b 0x1f 0x33 0x19 0x78 0x19 0x79 0x19 0x05 0x19 0x7a 0x19 0x2b 0x19 0x7b 0x19 0x2e 0x3b 0x06 0x1b>;
		clock-names = "aud_afe_clk\0aud_dac_clk\0aud_dac_predis_clk\0aud_adc_clk\0aud_apll22m_clk\0aud_apll1_tuner_clk\0aud_tml_clk\0aud_infra_clk\0mtkaif_26m_clk\0top_mux_audio\0top_mux_audio_int\0top_sys_pll1_d4\0top_mux_aud_1\0top_apll1_ck\0top_mux_aud_eng1\0top_apll1_d8\0apmixed_apll1\0top_clk26m_clk";
		linux,phandle = <0x8f>;
		phandle = <0x8f>;
	};

	audio_sram@11221000 {
		compatible = "mediatek,audio_sram";
		reg = <0x00 0x11221000 0x00 0x9000>;
	};

	mipi_rx_ana_csi0a@11c10000 {
		compatible = "mediatek,mipi_rx_ana_csi0a\0syscon";
		reg = <0x00 0x11c10000 0x00 0x1000>;
		#clock-cells = <0x01>;
		linux,phandle = <0x3d>;
		phandle = <0x3d>;
	};

	mipi_rx_ana_csi1@11c20000 {
		compatible = "mediatek,mipi_rx_ana_csi1";
		reg = <0x00 0x11c20000 0x00 0x10000>;
	};

	mipi_rx_ana_csi0b@11c11000 {
		compatible = "mediatek,mipi_rx_ana_csi0b\0syscon";
		reg = <0x00 0x11c11000 0x00 0x1000>;
		#clock-cells = <0x01>;
		linux,phandle = <0x3e>;
		phandle = <0x3e>;
	};

	mipi_rx_ana_csi1a@11c12000 {
		compatible = "mediatek,mipi_rx_ana_csi1a\0syscon";
		reg = <0x00 0x11c12000 0x00 0x1000>;
		#clock-cells = <0x01>;
		linux,phandle = <0x3f>;
		phandle = <0x3f>;
	};

	mipi_rx_ana_csi1b@11c13000 {
		compatible = "mediatek,mipi_rx_ana_csi1b\0syscon";
		reg = <0x00 0x11c13000 0x00 0x1000>;
		#clock-cells = <0x01>;
		linux,phandle = <0x40>;
		phandle = <0x40>;
	};

	mipi_rx_ana_csi2a@11c14000 {
		compatible = "mediatek,mipi_rx_ana_csi2a\0syscon";
		reg = <0x00 0x11c14000 0x00 0x1000>;
		#clock-cells = <0x01>;
		linux,phandle = <0x41>;
		phandle = <0x41>;
	};

	mipi_rx_ana_csi2b@11c15000 {
		compatible = "mediatek,mipi_rx_ana_csi2b\0syscon";
		reg = <0x00 0x11c15000 0x00 0x1000>;
		#clock-cells = <0x01>;
		linux,phandle = <0x42>;
		phandle = <0x42>;
	};

	mipi_rx_ana_csi2@11c30000 {
		compatible = "mediatek,mipi_rx_ana_csi2";
		reg = <0x00 0x11c30000 0x00 0x10000>;
	};

	efusec@11c50000 {
		compatible = "mediatek,efusec";
		reg = <0x00 0x11c50000 0x00 0x10000>;
	};

	mipi_tx0@11c80000 {
		compatible = "mediatek,mipi_tx0";
		reg = <0x00 0x11c80000 0x00 0x10000>;
	};

	msdc1_pad_macro@11c90000 {
		compatible = "mediatek,msdc1_pad_macro";
		reg = <0x00 0x11c90000 0x00 0x10000>;
	};

	msdc0_pad_macro@11cd0000 {
		compatible = "mediatek,msdc0_pad_macro";
		reg = <0x00 0x11cd0000 0x00 0x10000>;
	};

	mfg_clark@13000000 {
		compatible = "mediatek,clark";
		reg = <0x00 0x13000000 0x00 0x80000>;
		interrupts = <0x00 0xcb 0x08>;
		interrupt-names = "RGX";
		clock-frequency = <0x21f98280>;
	};

	mfg_cfg@13ffe000 {
		compatible = "mediatek,mfgcfg\0syscon";
		reg = <0x00 0x13ffe000 0x00 0x1000>;
		#clock-cells = <0x01>;
		linux,phandle = <0x90>;
		phandle = <0x90>;
	};

	gpufreq {
		compatible = "mediatek,mt6761-gpufreq";
		clocks = <0x19 0x6d 0x19 0x28 0x1b 0x20 0x07 0x20 0x04 0x20 0x06>;
		clock-names = "clk_mux\0clk_main_parent\0clk_sub_parent\0mtcmos_mfg_async\0mtcmos_mfg\0mtcmos_mfg_core0";
	};

	mmsys_config@14000000 {
		compatible = "mediatek,mmsys_config\0syscon";
		reg = <0x00 0x14000000 0x00 0x1000>;
		interrupts = <0x00 0xab 0x08>;
		#clock-cells = <0x01>;
		clocks = <0x21 0x17 0x21 0x1a 0x21 0x1b>;
		clock-names = "CAM_MDP\0IMG_DL_RELAY\0IMG_DL_ASYNC_TOP";
		linux,phandle = <0x21>;
		phandle = <0x21>;
	};

	nfc {
		compatible = "mediatek,nfc-gpio-v2";
		gpio-rst = <0xac>;
		gpio-rst-std = <0x37 0xac 0x00>;
		gpio-irq = <0x0a>;
		gpio-irq-std = <0x37 0x0a 0x00>;
		linux,phandle = <0x91>;
		phandle = <0x91>;
	};

	irq_nfc {
		compatible = "mediatek,irq_nfc-eint";
		linux,phandle = <0x92>;
		phandle = <0x92>;
	};

	disp_mutex0@14001000 {
		compatible = "mediatek,disp_mutex0";
		reg = <0x00 0x14001000 0x00 0x1000>;
		interrupts = <0x00 0x9a 0x08>;
		linux,phandle = <0x2a>;
		phandle = <0x2a>;
	};

	smi_common@14002000 {
		compatible = "mediatek,smi_common";
		reg = <0x00 0x14002000 0x00 0x1000>;
		nr_larbs = <0x03>;
		larbs = <0x1c 0x1d 0x1e>;
		mmsys_config = <0x21>;
		clocks = <0x20 0x03 0x21 0x15 0x21 0x16 0x21 0x13>;
		clock-names = "mtcmos-dis\0smi-comm0\0smi-comm1\0smi-common";
	};

	mmdvfs_pmqos {
		compatible = "mediatek,mmdvfs_pmqos";
		mm_step0 = <0x1b4 0x01 0x00 0x01>;
		mm_step0_ext = <0x1b4 0x02 0x06 0x10c4ec>;
		mm_step1 = <0x138 0x01 0x00 0x02>;
		mm_step1_ext = <0x138 0x02 0x06 0x10c4ec>;
		mm_step2 = <0xe3 0x01 0x00 0x03>;
		mm_step2_ext = <0xe3 0x02 0x06 0x117627>;
		vopp_steps = <0x00 0x01 0x03>;
		disp_freq = "mm_step0\0mm_step1\0mm_step2";
		mdp_freq = "mm_step0\0mm_step1\0mm_step2";
		cam_freq = "mm_step0\0mm_step1\0mm_step2";
		img_freq = "mm_step0\0mm_step1\0mm_step2";
		vdec_freq = "mm_step0\0mm_step1\0mm_step2";
		venc_freq = "mm_step0\0mm_step1\0mm_step2";
		clocks = <0x19 0x6b 0x19 0x24 0x19 0x1a 0x19 0x25>;
		clock-names = "mmdvfs_clk_mm_sel_ck\0mmdvfs_clk_mmpll_ck\0mmdvfs_clk_univpll1_d2_ck\0mmdvfs_clk_mmpll_d2_ck";
	};

	smi_larb0@14003000 {
		cell-index = <0x00>;
		compatible = "mediatek,smi_larb0\0mediatek,smi_larb";
		reg = <0x00 0x14003000 0x00 0x1000>;
		clocks = <0x20 0x03 0x21 0x14>;
		clock-names = "mtcmos-dis\0smi-larb0";
		linux,phandle = <0x1c>;
		phandle = <0x1c>;
	};

	mdp_rdma0@14004000 {
		compatible = "mediatek,mdp_rdma0";
		reg = <0x00 0x14004000 0x00 0x1000>;
		interrupts = <0x00 0x9b 0x08>;
		clocks = <0x21 0x00>;
		clock-names = "MDP_RDMA0";
		linux,phandle = <0x22>;
		phandle = <0x22>;
	};

	mdp_ccorr0@14005000 {
		compatible = "mediatek,mdp_ccorr0";
		reg = <0x00 0x14005000 0x00 0x1000>;
		interrupts = <0x00 0xaa 0x08>;
		clocks = <0x21 0x01>;
		clock-names = "MDP_CCORR";
		linux,phandle = <0x29>;
		phandle = <0x29>;
	};

	mdp_rsz0@14006000 {
		compatible = "mediatek,mdp_rsz0";
		reg = <0x00 0x14006000 0x00 0x1000>;
		interrupts = <0x00 0x9c 0x08>;
		clocks = <0x21 0x02>;
		clock-names = "MDP_RSZ0";
		linux,phandle = <0x23>;
		phandle = <0x23>;
	};

	mdp_rsz1@14007000 {
		compatible = "mediatek,mdp_rsz1";
		reg = <0x00 0x14007000 0x00 0x1000>;
		interrupts = <0x00 0x9d 0x08>;
		clocks = <0x21 0x03>;
		clock-names = "MDP_RSZ1";
		linux,phandle = <0x24>;
		phandle = <0x24>;
	};

	mdp_wdma0@14008000 {
		compatible = "mediatek,mdp_wdma0";
		reg = <0x00 0x14008000 0x00 0x1000>;
		interrupts = <0x00 0xa0 0x08>;
		clocks = <0x21 0x06>;
		clock-names = "MDP_WDMA";
		linux,phandle = <0x25>;
		phandle = <0x25>;
	};

	mdp_wrot0@14009000 {
		compatible = "mediatek,mdp_wrot0";
		reg = <0x00 0x14009000 0x00 0x1000>;
		interrupts = <0x00 0x9f 0x08>;
		clocks = <0x21 0x05>;
		clock-names = "MDP_WROT0";
		linux,phandle = <0x26>;
		phandle = <0x26>;
	};

	mdp_tdshp0@1400a000 {
		compatible = "mediatek,mdp_tdshp0";
		reg = <0x00 0x1400a000 0x00 0x1000>;
		clocks = <0x21 0x04>;
		clock-names = "MDP_TDSHP";
		linux,phandle = <0x27>;
		phandle = <0x27>;
	};

	disp_ovl0@1400b000 {
		compatible = "mediatek,disp_ovl0";
		reg = <0x00 0x1400b000 0x00 0x1000>;
		interrupts = <0x00 0xa1 0x08>;
	};

	disp_ovl0_2l@1400c000 {
		compatible = "mediatek,disp_ovl0_2l";
		reg = <0x00 0x1400c000 0x00 0x1000>;
		interrupts = <0x00 0xad 0x08>;
	};

	disp_rdma0@1400d000 {
		compatible = "mediatek,disp_rdma0";
		reg = <0x00 0x1400d000 0x00 0x1000>;
		interrupts = <0x00 0xa2 0x08>;
	};

	disp_wdma0@1400e000 {
		compatible = "mediatek,disp_wdma0";
		reg = <0x00 0x1400e000 0x00 0x1000>;
		interrupts = <0x00 0xa3 0x08>;
	};

	disp_color0@1400f000 {
		compatible = "mediatek,disp_color0";
		reg = <0x00 0x1400f000 0x00 0x1000>;
		interrupts = <0x00 0xa4 0x08>;
		linux,phandle = <0x28>;
		phandle = <0x28>;
	};

	disp_ccorr0@14010000 {
		compatible = "mediatek,disp_ccorr0";
		reg = <0x00 0x14010000 0x00 0x1000>;
		interrupts = <0x00 0xa5 0x08>;
	};

	disp_aal0@14011000 {
		compatible = "mediatek,disp_aal0";
		reg = <0x00 0x14011000 0x00 0x1000>;
		interrupts = <0x00 0xa6 0x08>;
	};

	disp_gamma0@14012000 {
		compatible = "mediatek,disp_gamma0";
		reg = <0x00 0x14012000 0x00 0x1000>;
		interrupts = <0x00 0xa7 0x08>;
	};

	disp_dither0@14013000 {
		compatible = "mediatek,disp_dither0";
		reg = <0x00 0x14013000 0x00 0x1000>;
		interrupts = <0x00 0xa8 0x08>;
	};

	dsi0@14014000 {
		compatible = "mediatek,dsi0";
		reg = <0x00 0x14014000 0x00 0x1000>;
		interrupts = <0x00 0xa9 0x08>;
	};

	disp_rsz0@14015000 {
		compatible = "mediatek,disp_rsz0";
		reg = <0x00 0x14015000 0x00 0x1000>;
		interrupts = <0x00 0xdc 0x08>;
	};

	mtkfb@0 {
		compatible = "mediatek,mtkfb";
		linux,phandle = <0x93>;
		phandle = <0x93>;
	};

	dispsys {
		compatible = "mediatek,dispsys";
		mediatek,larb = <0x1c>;
		clocks = <0x20 0x03 0x21 0x13 0x21 0x14 0x21 0x15 0x21 0x16 0x21 0x07 0x21 0x08 0x21 0x0a 0x21 0x0b 0x21 0x0c 0x21 0x0d 0x21 0x0e 0x21 0x0f 0x21 0x10 0x21 0x11 0x21 0x1c 0x21 0x1d 0x21 0x09 0x3b 0x13 0x19 0x7c 0x1f 0x31 0x1b 0x19 0x1e 0x19 0x2f 0x19 0x31>;
		clock-names = "MMSYS_MTCMOS\0MMSYS_SMI_COMMON\0MMSYS_SMI_LARB0\0MMSYS_GALS_COMM0\0MMSYS_GALS_COMM1\0MMSYS_DISP_OVL0\0MMSYS_DISP_OVL0_2L\0MMSYS_DISP_RDMA0\0MMSYS_DISP_WDMA0\0MMSYS_DISP_COLOR0\0MMSYS_DISP_CCORR0\0MMSYS_DISP_AAL0\0MMSYS_DISP_GAMMA0\0MMSYS_DISP_DITHER0\0MMSYS_DSI0_MM_CK\0MMSYS_DSI0_IF_CK\0MMSYS_26M\0MMSYS_DISP_RSZ0\0APMIXED_MIPI_26M\0TOP_MUX_DISP_PWM\0DISP_PWM\0TOP_26M\0TOP_UNIVPLL2_D4\0TOP_ULPOSC1_D2\0TOP_ULPOSC1_D8";
	};

	dsi_te {
		compatible = "mediatek, DSI_TE-eint";
		status = "disabled";
		linux,phandle = <0x94>;
		phandle = <0x94>;
	};

	mm_mutex@14016000 {
		compatible = "mediatek,mm_mutex";
		reg = <0x00 0x14016000 0x00 0x1000>;
		linux,phandle = <0x95>;
		phandle = <0x95>;
	};

	camsys@15000000 {
		compatible = "mediatek,camsys\0syscon";
		reg = <0x00 0x15000000 0x00 0x1000>;
		#clock-cells = <0x01>;
		linux,phandle = <0x3c>;
		phandle = <0x3c>;
	};

	ispsys@15000000 {
		compatible = "mediatek,mt6761-ispsys";
		reg = <0x00 0x15004000 0x00 0x9000 0x00 0x1500d000 0x00 0x1000 0x00 0x15000000 0x00 0x52000 0x00 0x15040000 0x00 0x8000 0x00 0x10215000 0x00 0x3000 0x00 0x10211000 0x00 0x1000>;
		interrupts = <0x00 0xb3 0x08 0x00 0xb4 0x08 0x00 0xb5 0x08 0x00 0xb8 0x08 0x00 0xb9 0x08 0x00 0xba 0x08 0x00 0xbb 0x08>;
		clocks = <0x20 0x03 0x20 0x08 0x3c 0x00 0x3c 0x01 0x3c 0x02 0x3c 0x03 0x3c 0x04 0x3c 0x05 0x21 0x15 0x21 0x16 0x21 0x13>;
		clock-names = "CG_SCP_SYS_DIS\0CG_SCP_SYS_CAM\0CG_CAM_LARB2\0CG_CAM\0CG_CAMTG\0CG_CAM_SENINF\0CG_CAMSV0\0CG_CAMSV1\0CG_MM_SMI_COMM0\0CG_MM_SMI_COMM1\0CG_MM_SMI_COMMON";
	};

	smi_larb2@15001000 {
		cell-index = <0x02>;
		compatible = "mediatek,smi_larb2\0mediatek,smi_larb";
		reg = <0x00 0x15001000 0x00 0x1000>;
		clocks = <0x20 0x08 0x21 0x18 0x3c 0x00>;
		clock-names = "mtcmos-cam\0gals-cam2img\0cam-larb2";
		linux,phandle = <0x1e>;
		phandle = <0x1e>;
	};

	cam@15004000 {
		compatible = "mediatek,cam";
		reg = <0x00 0x15004000 0x00 0x1000>;
	};

	cam_lut@15005000 {
		compatible = "mediatek,cam_lut";
		reg = <0x00 0x15005000 0x00 0x1000>;
	};

	camd@15006000 {
		compatible = "mediatek,camd";
		reg = <0x00 0x15006000 0x00 0x1000>;
	};

	cam_dma@15007000 {
		compatible = "mediatek,cam_dma";
		reg = <0x00 0x15007000 0x00 0x1000>;
	};

	fdvt@1500b000 {
		compatible = "mediatek,fdvt";
		reg = <0x00 0x1500b000 0x00 0x1000>;
		interrupts = <0x00 0xb6 0x08>;
		clocks = <0x3c 0x06>;
		clock-names = "FD_CLK_CAM_FDVT";
	};

	cam_inner@1500d000 {
		compatible = "mediatek,cam_inner";
		reg = <0x00 0x1500d000 0x00 0x1000>;
	};

	camd_inner@1500e000 {
		compatible = "mediatek,camd_inner";
		reg = <0x00 0x1500e000 0x00 0x1000>;
	};

	cam_inner_dma@1500f000 {
		compatible = "mediatek,cam_inner_dma";
		reg = <0x00 0x1500f000 0x00 0x1000>;
	};

	camsv0@15050000 {
		compatible = "mediatek,camsv0";
		reg = <0x00 0x15050000 0x00 0x1000>;
	};

	camsv1@15051000 {
		compatible = "mediatek,camsv1";
		reg = <0x00 0x15051000 0x00 0x1000>;
	};

	kd_camera_hw1@15040000 {
		compatible = "mediatek,camera_hw";
		reg = <0x00 0x15040000 0x00 0x1000>;
		clocks = <0x19 0x6f 0x19 0x70 0x19 0x71 0x19 0x72 0x19 0x16 0x19 0x15 0x19 0x20 0x19 0x13 0x19 0x1f 0x19 0x14 0x1b 0x3c 0x03 0x3b 0x0c 0x3b 0x10 0x3d 0x00 0x3e 0x00 0x3f 0x00 0x40 0x00 0x41 0x00 0x42 0x00 0x19 0x86 0x19 0x1d 0x20 0x08>;
		clock-names = "CLK_TOP_CAMTG_SEL\0CLK_TOP_CAMTG1_SEL\0CLK_TOP_CAMTG2_SEL\0CLK_TOP_CAMTG3_SEL\0CLK_MCLK_6M\0CLK_MCLK_12M\0CLK_MCLK_13M\0CLK_MCLK_48M\0CLK_MCLK_52M\0CLK_MCLK_24M\0CLK_MCLK_26M\0CLK_CAM_SENINF_CG\0CLK_MIPI_C0_26M_CG\0CLK_MIPI_C1_26M_CG\0CLK_MIPI_ANA_0A_CG\0CLK_MIPI_ANA_0B_CG\0CLK_MIPI_ANA_1A_CG\0CLK_MIPI_ANA_1B_CG\0CLK_MIPI_ANA_2A_CG\0CLK_MIPI_ANA_2B_CG\0CLK_TOP_CAMTM_SEL_CG\0CLK_TOP_CAMTM_208_CG\0CLK_SCP_SYS_CAM";
		linux,phandle = <0x96>;
		phandle = <0x96>;
	};

	flashlight_core {
		compatible = "mediatek,flashlight_core";
		linux,phandle = <0x97>;
		phandle = <0x97>;
	};

	flashlights_mt6370 {
		compatible = "mediatek,flashlights_mt6370";
		decouple = <0x00>;
		linux,phandle = <0x98>;
		phandle = <0x98>;

		channel@1 {
			type = <0x00>;
			ct = <0x00>;
			part = <0x00>;
		};

		channel@2 {
			type = <0x00>;
			ct = <0x01>;
			part = <0x00>;
		};
	};

	flashlights_aw3644 {
		compatible = "mediatek,flashlights_aw3644";
		linux,phandle = <0x99>;
		phandle = <0x99>;
	};

	venc_gcon@17000000 {
		compatible = "mediatek,venc_gcon\0syscon";
		reg = <0x00 0x17000000 0x00 0x10000>;
		clocks = <0x20 0x03 0x20 0x09 0x21 0x15 0x21 0x16 0x21 0x13 0x43 0x03 0x43 0x01>;
		clock-names = "MT_SCP_SYS_DIS\0MT_SCP_SYS_VCODEC\0MT_CG_MM_SMI_COMM0\0MT_CG_MM_SMI_COMM1\0MT_CG_MM_SMI_COMMON\0MT_CG_VDEC\0MT_CG_VENC";
		#clock-cells = <0x01>;
		linux,phandle = <0x43>;
		phandle = <0x43>;
	};

	smi_larb1@17010000 {
		cell-index = <0x01>;
		compatible = "mediatek,smi_larb1\0mediatek,smi_larb";
		reg = <0x00 0x17010000 0x00 0x10000>;
		clocks = <0x20 0x09 0x43 0x01>;
		clock-names = "mtcmos-vcodec\0venc-larb1";
		linux,phandle = <0x1d>;
		phandle = <0x1d>;
	};

	venc@17020000 {
		compatible = "mediatek,venc";
		reg = <0x00 0x17020000 0x00 0x10000>;
		interrupts = <0x00 0xae 0x08>;
	};

	venc_jpg@17030000 {
		compatible = "mediatek,venc_jpg";
		reg = <0x00 0x17030000 0x00 0x10000>;
		interrupts = <0x00 0xb0 0x08>;
		clocks = <0x43 0x02>;
		clock-names = "MT_CG_VENC_JPGENC";
	};

	vdec@17040000 {
		compatible = "mediatek,vdec";
		reg = <0x00 0x17040000 0x00 0x10000>;
		interrupts = <0x00 0xb1 0x08>;
	};

	mbist@17050000 {
		compatible = "mediatek,mbist";
		reg = <0x00 0x17050000 0x00 0x10000>;
	};

	otg_iddig {
		compatible = "mediatek,usb_iddig_bi_eint";
		linux,phandle = <0x9a>;
		phandle = <0x9a>;
	};

	odm {
		compatible = "simple-bus";
		linux,phandle = <0x9b>;
		phandle = <0x9b>;
	};

	radio_md_cfg {
		compatible = "mediatek,radio_md_cfg";
		linux,phandle = <0x9c>;
		phandle = <0x9c>;
	};

	dynamic_options {
		compatible = "mediatek,dynamic_options";
		linux,phandle = <0x9d>;
		phandle = <0x9d>;
	};

	audio_snd_card {
		compatible = "mediatek,audio_snd_card";
	};

	mt_soc_deep_buffer_dl_pcm {
		compatible = "mediatek,mt_soc_pcm_deep_buffer_dl";
	};

	mt_soc_ul1_pcm {
		compatible = "mediatek,mt_soc_pcm_capture";
	};

	mt_soc_voice_md1 {
		compatible = "mediatek,mt_soc_pcm_voice_md1";
	};

	mt_soc_uldlloopback_pcm {
		compatible = "mediatek,mt_soc_pcm_uldlloopback";
	};

	mt_soc_i2s0_pcm {
		compatible = "mediatek,mt_soc_pcm_dl1_i2s0";
	};

	mt_soc_mrgrx_pcm {
		compatible = "mediatek,mt_soc_pcm_mrgrx";
	};

	mt_soc_mrgrx_awb_pcm {
		compatible = "mediatek,mt_soc_pcm_mrgrx_awb";
	};

	mt_soc_fm_i2s_pcm {
		compatible = "mediatek,mt_soc_pcm_fm_i2s";
	};

	mt_soc_fm_i2s_awb_pcm {
		compatible = "mediatek,mt_soc_pcm_fm_i2s_awb";
	};

	mt_soc_i2s0dl1_pcm {
		compatible = "mediatek,mt_soc_pcm_dl1_i2s0dl1";
	};

	mt_soc_dl1_awb_pcm {
		compatible = "mediatek,mt_soc_pcm_dl1_awb";
	};

	mt_soc_voice_md1_bt {
		compatible = "mediatek,mt_soc_pcm_voice_md1_bt";
	};

	mt_soc_voip_bt_out {
		compatible = "mediatek,mt_soc_pcm_dl1_bt";
	};

	mt_soc_voip_bt_in {
		compatible = "mediatek,mt_soc_pcm_bt_dai";
	};

	mt_soc_tdmrx_pcm {
		compatible = "mediatek,mt_soc_tdm_capture";
	};

	mt_soc_fm_mrgtx_pcm {
		compatible = "mediatek,mt_soc_pcm_fmtx";
	};

	mt_soc_ul2_pcm {
		compatible = "mediatek,mt_soc_pcm_capture2";
	};

	mt_soc_i2s0_awb_pcm {
		compatible = "mediatek,mt_soc_pcm_i2s0_awb";
	};

	mt_soc_voice_md2 {
		compatible = "mediatek,mt_soc_pcm_voice_md2";
	};

	mt_soc_routing_pcm {
		compatible = "mediatek,mt_soc_pcm_routing";
	};

	mt_soc_voice_md2_bt {
		compatible = "mediatek,mt_soc_pcm_voice_md2_bt";
	};

	mt_soc_hp_impedance_pcm {
		compatible = "mediatek,mt_soc_pcm_hp_impedance";
	};

	mt_soc_codec_name {
		compatible = "mediatek,mt_soc_codec_63xx";
		use_hp_depop_flow = <0x00>;
		use_ul_260k = <0x00>;
	};

	mt_soc_dummy_pcm {
		compatible = "mediatek,mt_soc_pcm_dummy";
	};

	mt_soc_codec_dummy_name {
		compatible = "mediatek,mt_soc_codec_dummy";
	};

	mt_soc_routing_dai_name {
		compatible = "mediatek,mt_soc_dai_routing";
	};

	mt_soc_dai_name {
		compatible = "mediatek,mt_soc_dai_stub";
	};

	mt_soc_dl2_pcm {
		compatible = "mediatek,mt_soc_pcm_dl2";
	};

	mt_soc_anc_pcm {
		compatible = "mediatek,mt_soc_pcm_anc";
	};

	mt_soc_pcm_voice_ultra {
		compatible = "mediatek,mt_soc_pcm_voice_ultra";
	};

	mt_soc_pcm_voice_usb {
		compatible = "mediatek,mt_soc_pcm_voice_usb";
	};

	mt_soc_pcm_voice_usb_echoref {
		compatible = "mediatek,mt_soc_pcm_voice_usb_echoref";
	};

	mt_soc_btcvsd_rx_pcm {
		compatible = "mediatek,mt_soc_btcvsd_rx_pcm";
	};

	mt_soc_btcvsd_tx_pcm {
		compatible = "mediatek,mt_soc_btcvsd_tx_pcm";
	};

	firmware {

		android {
			compatible = "android,firmware";

			vbmeta {
				compatible = "android,vbmeta";
				parts = "vbmeta,boot,system,vendor,recovery";
			};

			fstab {
				compatible = "android,fstab";

				vendor {
					compatible = "android,vendor";
					dev = "/dev/block/platform/bootdevice/by-name/vendor";
					type = "ext4";
					mnt_flags = "ro";
					fsmgr_flags = "wait,avb";
				};
			};
		};
	};

	mt6357_charger {
		compatible = "mediatek,mt6357_charger";
	};

	mt_charger {
		compatible = "mediatek,mt-charger";
		linux,phandle = <0x9e>;
		phandle = <0x9e>;
	};

	lk_charger {
		compatible = "mediatek,lk_charger";
		enable_anime;
		max_charger_voltage = <0x632ea0>;
		fast_charge_voltage = <0x2dc6c0>;
		usb_charger_current = <0x7a120>;
		ac_charger_current = <0xdbba0>;
		ac_charger_input_current = <0xdbba0>;
		non_std_ac_charger_current = <0x7a120>;
		charging_host_charger_current = <0xf4240>;
		ta_ac_charger_current = <0x2dc6c0>;
		pd_charger_current = <0x7a120>;
		temp_t4_threshold = <0x32>;
		temp_t3_threshold = <0x2d>;
		temp_t1_threshold = <0x00>;
		linux,phandle = <0x9f>;
		phandle = <0x9f>;
	};

	charger {
		compatible = "mediatek,charger";
		algorithm_name = "LinearCharging";
		enable_sw_jeita;
		battery_cv = <0x432380>;
		max_charger_voltage = <0x632ea0>;
		min_charger_voltage = <0x4630c0>;
		usb_charger_current_suspend = <0x00>;
		usb_charger_current_unconfigured = <0x11170>;
		usb_charger_current_configured = <0x7a120>;
		usb_charger_current = <0x7a120>;
		ac_charger_current = <0x124f80>;
		ac_charger_input_current = <0x124f80>;
		non_std_ac_charger_current = <0x7a120>;
		charging_host_charger_current = <0xf4240>;
		apple_1_0a_charger_current = <0x9eb10>;
		apple_2_1a_charger_current = "\0\f5";
		ta_ac_charger_current = <0x2dc6c0>;
		jeita_temp_above_t4_cv = <0x3e8fa0>;
		jeita_temp_t3_to_t4_cv = <0x3e8fa0>;
		jeita_temp_t2_to_t3_cv = <0x432380>;
		jeita_temp_t1_to_t2_cv = <0x432380>;
		jeita_temp_t0_to_t1_cv = <0x432380>;
		jeita_temp_below_t0_cv = <0x432380>;
		temp_t4_thres = <0x37>;
		temp_t4_thres_minus_x_degree = <0x33>;
		temp_t3_thres = <0x2d>;
		temp_t3_thres_minus_x_degree = <0x2c>;
		temp_t2_thres = <0x0f>;
		temp_t2_thres_plus_x_degree = <0x10>;
		temp_t1_thres = <0x01>;
		temp_t1_thres_plus_x_degree = <0x01>;
		temp_t0_thres = <0x01>;
		temp_t0_thres_plus_x_degree = <0x01>;
		temp_neg_10_thres = <0x02>;
		enable_min_charge_temp;
		min_charge_temp = <0x00>;
		min_charge_temp_plus_x_degree = <0x01>;
		max_charge_temp = <0x35>;
		max_charge_temp_minus_x_degree = <0x34>;
		ta_12v_support;
		ta_9v_support;
		pe_ichg_level_threshold = <0xf4240>;
		ta_ac_12v_input_current = <0x30d400>;
		ta_ac_9v_input_current = <0x30d400>;
		ta_ac_7v_input_current = <0x30d400>;
		pe20_ichg_level_threshold = <0xf4240>;
		ta_start_battery_soc = <0x00>;
		ta_stop_battery_soc = <0x55>;
		pe40_single_charger_input_current = <0x2dc6c0>;
		pe40_single_charger_current = <0x2dc6c0>;
		pe40_dual_charger_input_current = <0x2dc6c0>;
		pe40_dual_charger_chg1_current = <0x1e8480>;
		pe40_dual_charger_chg2_current = <0x1e8480>;
		pe40_stop_battery_soc = <0x50>;
		pe40_r_cable_1a_lower = <0x212>;
		pe40_r_cable_2a_lower = <0x186>;
		pe40_r_cable_3a_lower = <0xfc>;
		chg1_ta_ac_charger_current = <0x16e360>;
		chg2_ta_ac_charger_current = <0x16e360>;
		cable_imp_threshold = <0x2bb>;
		vbat_cable_imp_threshold = <0x3b8260>;
		bif_threshold1 = <0x40d990>;
		bif_threshold2 = <0x419ce0>;
		bif_cv_under_threshold2 = <0x43e6d0>;
		enable_sw_safety_timer;
		max_charging_time = <0xa8c0>;
		recharge_offset = <0x186a0>;
		topoff_voltage = <0x3e8fa0>;
		chg_full_current = <0x30d40>;
		linux,phandle = <0xa0>;
		phandle = <0xa0>;
	};

	pmic_clock_buffer_ctrl {
		compatible = "mediatek,pmic_clock_buffer";
		mediatek,clkbuf-quantity = <0x07>;
		mediatek,clkbuf-config = <0x02 0x01 0x01 0x02 0x00 0x00 0x00>;
		mediatek,clkbuf-driving-current = <0x01 0x01 0x01 0x01 0x01 0x01 0x01>;
		linux,phandle = <0xa1>;
		phandle = <0xa1>;
	};

	pseudo_m4u {
		compatible = "mediatek,mt-pseudo_m4u";
		iommus = <0x44 0x02>;
	};

	pseudo_m4u-larb0 {
		compatible = "mediatek,mt-pseudo_m4u-port";
		mediatek,larbid = <0x00>;
		iommus = <0x44 0x00 0x44 0x01 0x44 0x02 0x44 0x03 0x44 0x04 0x44 0x05 0x44 0x06 0x44 0x07>;
	};

	pseudo_m4u-larb1 {
		compatible = "mediatek,mt-pseudo_m4u-port";
		mediatek,larbid = <0x01>;
		iommus = <0x44 0x20 0x44 0x21>;
	};

	pseudo_m4u-larb2 {
		compatible = "mediatek,mt-pseudo_m4u-port";
		mediatek,larbid = <0x02>;
		iommus = <0x44 0x40 0x44 0x41>;
	};

	trusty {
		compatible = "android,trusty-smc-v1";
		ranges;
		#address-cells = <0x02>;
		#size-cells = <0x02>;

		irq {
			compatible = "android,trusty-irq-v1";
			ppi-interrupt-parent = <0x0d>;
		};

		log {
			compatible = "android,trusty-log-v1";
		};

		virtio {
			compatible = "android,trusty-virtio-v1";
		};

		mtee {
			compatible = "mediatek,trusty-mtee-v1";
		};
	};

	mt6370_pmu_dts {
		interrupt-controller;
		#interrupt-cells = <0x01>;
		mt6370,intr_gpio_num = <0x03>;
		mt6370,intr_gpio = <0x37 0x03 0x00>;
		linux,phandle = <0xa2>;
		phandle = <0xa2>;

		core {
			compatible = "mediatek,mt6370_pmu_core";
			interrupt-names = "otp\0vdda_ovp\0vdda_uv";
			i2cstmr_rst_tmr = <0x00>;
			mrstb_en;
			mrstb_tmr = <0x03>;
			int_wdt = <0x00>;
			int_deg = <0x00>;
		};

		charger {
			compatible = "mediatek,mt6370_pmu_charger";
			interrupt-names = "chg_mivr\0chg_aiclmeasi\0attachi\0ovpctrl_uvp_d_evt\0chg_wdtmri\0chg_vbusov\0chg_tmri\0chg_treg";
			charger_name = "primary_chg";
			load_switch_name = "primary_load_switch";
			ichg = <0x1e8480>;
			aicr = <0x7a120>;
			mivr = <0x432380>;
			cv = <0x426030>;
			ieoc = <0x249f0>;
			safety_timer = <0x0c>;
			dc_wdt = "\0=\t";
			ircmp_resistor = <0x61a8>;
			ircmp_vclamp = <0x7d00>;
			enable_te;
			enable_wdt;
		};

		mt6370_pmu_fled1 {
			compatible = "mediatek,mt6370_pmu_fled1";
			interrupt-names = "fled_lvf\0fled2_short\0fled1_short";
			fled_enable = <0x01>;
			torch_cur = <0x493e0>;
			strobe_cur = <0x124f80>;
			strobe_timeout = <0x960>;
		};

		mt6370_pmu_fled2 {
			compatible = "mediatek,mt6370_pmu_fled2";
			fled_enable = <0x01>;
			torch_cur = <0x30d40>;
			strobe_cur = <0xf4240>;
			strobe_timeout = <0x4b0>;
		};

		ldo {
			compatible = "mediatek,mt6370_pmu_ldo";
			interrupt-names = "ldo_oc";
			ldo_oms = <0x01>;
			ldo_vrc_lt = <0x01>;

			mt6370_ldo {
				regulator-name = "irtx_ldo";
				regulator-min-microvolt = <0x186a00>;
				regulator-max-microvolt = "\0=\t";
			};
		};

		rgbled {
			compatible = "mediatek,mt6370_pmu_rgbled";
			interrupt-names = "isink4_short\0isink3_short\0isink2_short\0isink1_short\0isink4_open\0isink3_open\0isink2_open\0isink1_open";
			mt,led_name = "mt6370_pmu_led1\0mt6370_pmu_led2\0mt6370_pmu_led3\0mt6370_pmu_led4";
			mt,led_default_trigger = "cc_mode\0cc_mode\0cc_mode\0none";
		};

		bled {
			compatible = "mediatek,mt6370_pmu_bled";
			interrupt-names = "bled_ocp";
			mt,bled_name = "mt6370_pmu_bled";
			mt,chan_en = <0x0f>;
			mt,map_linear;
			mt,bl_ovp_level = <0x03>;
			mt,bl_ocp_level = <0x02>;
			mt,use_pwm;
			mt,pwm_fsample = <0x02>;
			mt,pwm_deglitch = <0x01>;
			mt,pwm_avg_cycle = <0x00>;
			mt,bled_ramptime = <0x03>;
			mt,bled_flash_ramp = <0x01>;
			mt,max_bled_brightness = <0x200>;
		};

		dsv {
			compatible = "mediatek,mt6370_pmu_dsv";
			interrupt-names = "dsv_vneg_ocp\0dsv_vpos_ocp\0dsv_bst_ocp\0dsv_vneg_scp\0dsv_vpos_scp";
			db_ext_en = <0x00>;
			db_periodic_fix = <0x00>;
			db_single_pin = <0x00>;
			db_freq_pm = <0x00>;
			db_periodic_mode = <0x00>;
			db_startup = <0x00>;
			db_vneg_20ms = <0x01>;
			db_vneg_disc = <0x00>;
			db_vpos_20ms = <0x01>;
			db_vpos_disc = <0x00>;
			db_delay = <0x03>;
			db_vbst = <0x1644>;
			db_vpos_slew = <0x01>;
			db_vneg_slew = <0x01>;

			mt6370_dsvp {
				regulator-name = "dsv_pos";
				regulator-min-microvolt = "\0=\t";
				regulator-max-microvolt = <0x5b8d80>;
			};

			mt6370_dsvn {
				regulator-name = "dsv_neg";
				regulator-min-microvolt = "\0=\t";
				regulator-max-microvolt = <0x5b8d80>;
			};
		};
	};

	type_c_port0 {
		tcpc-dual,supported_modes = <0x00>;
		mt-tcpc,name = "type_c_port0";
		mt-tcpc,role_def = <0x04>;
		mt-tcpc,rp_level = <0x00>;
		mt-tcpc,vconn_supply = <0x01>;
		mt6370pd,intr_gpio = <0x37 0x18 0x00>;
		mt6370pd,intr_gpio_num = <0x18>;
		linux,phandle = <0xa3>;
		phandle = <0xa3>;

		pd-data {
			pd,vid = <0x29cf>;
			pd,pid = <0x5081>;
			pd,source-cap-ext = <0x171129cf 0x00 0x102 0x00 0x00 0x2000000>;
			pd,mfrs = "RichtekTCPC";
			pd,charging_policy = <0x21>;
			pd,source-pdo-size = <0x01>;
			pd,source-pdo-data = <0x19032>;
			pd,sink-pdo-size = <0x02>;
			pd,sink-pdo-data = <0x190c8 0xc0761e3c>;
			pd,id-vdo-size = <0x03>;
			pd,id-vdo-data = <0xd10029cf 0x00 0x10000>;
			bat,nr = <0x01>;
			pd,country_nr = <0x00>;

			bat-info0 {
				bat,vid = <0x29cf>;
				bat,pid = <0x1711>;
				bat,mfrs = "bat1";
				bat,design_cap = <0xbb8>;
			};
		};

		dpm_caps {
			local_dr_power;
			local_dr_data;
			local_usb_comm;
			local_no_suspend;
			local_vconn_supply;
			attemp_enter_dp_mode;
			attemp_discover_cable;
			attemp_discover_id;
			pr_check = <0x00>;
			pr_check_gp_source;
			dr_check = <0x00>;
		};
	};

	__symbols__ {
		chosen = "/chosen";
		cpu0 = "/cpus/cpu@000";
		cpu1 = "/cpus/cpu@001";
		cpu2 = "/cpus/cpu@002";
		cpu3 = "/cpus/cpu@003";
		STANDBY = "/cpus/idle-states/standby";
		MCDI_CPU = "/cpus/idle-states/mcdi-cpu";
		MCDI_CLUSTER = "/cpus/idle-states/mcdi-cluster";
		SODI = "/cpus/idle-states/sodi";
		SODI3 = "/cpus/idle-states/sodi3";
		DPIDLE = "/cpus/idle-states/dpidle";
		SUSPEND = "/cpus/idle-states/suspend";
		cpu_dbgapb = "/cpu_dbgapb@0d410000";
		gic = "/interrupt-controller@0c000000";
		sysirq = "/intpol-controller@10200a80";
		infracfg_ao = "/infracfg_ao@10001000";
		scpsys = "/scpsys@10001000";
		topckgen = "/topckgen@10000000";
		syscfg_pctl_1 = "/syscfg_pctl_1@10002000";
		syscfg_pctl_2 = "/syscfg_pctl_2@10002200";
		syscfg_pctl_3 = "/syscfg_pctl_3@10002400";
		syscfg_pctl_4 = "/syscfg_pctl_4@10002600";
		syscfg_pctl_5 = "/syscfg_pctl_5@10002800";
		syscfg_pctl_6 = "/syscfg_pctl_6@10002a00";
		syscfg_pctl_7 = "/syscfg_pctl_7@10002c00";
		pericfg = "/pericfg@10003000";
		smart_pa = "/smart_pa";
		tcpc_pd = "/tcpc_pd";
		md1_sim1_hot_plug_eint = "/md1_sim1_hot_plug_eint";
		md1_sim2_hot_plug_eint = "/md1_sim2_hot_plug_eint";
		gpio_usage_mapping = "/gpio";
		gpio = "/gpio@10005000";
		syscfg_pctl_0 = "/syscfg_pctl_0@10005000";
		pio = "/pinctrl@1000b000";
		msdc0_pins_default = "/pinctrl@1000b000/msdc0@default";
		msdc0_pins_hs400 = "/pinctrl@1000b000/msdc0@hs400";
		msdc0_pins_hs200 = "/pinctrl@1000b000/msdc0@hs200";
		msdc0_register_setting_default = "/pinctrl@1000b000/msdc0@register_default";
		msdc1_pins_default = "/pinctrl@1000b000/msdc1@default";
		msdc1_pins_sdr104 = "/pinctrl@1000b000/msdc1@sdr104";
		msdc1_pins_sdr50 = "/pinctrl@1000b000/msdc1@sdr50";
		msdc1_pins_ddr50 = "/pinctrl@1000b000/msdc1@ddr50";
		msdc1_register_setting_default = "/pinctrl@1000b000/msdc1@register_default";
		msdc3_pins_default = "/pinctrl@1000b000/msdc3@default";
		msdc3_register_setting_default = "/pinctrl@1000b000/msdc3@register_default";
		clk26m = "/clocks/clk26m";
		clk32k = "/clocks/clk32k";
		timer = "/timer@10008000";
		apmixed = "/apmixed@1000c000";
		main_pmic = "/mt-pmic";
		pmic_auxadc = "/mt-pmic/mt635x-auxadc";
		mt_pmic_vs1_buck_reg = "/mt-pmic/buck_regulators/buck_vs1";
		mt_pmic_vmodem_buck_reg = "/mt-pmic/buck_regulators/buck_vmodem";
		mt_pmic_vcore_buck_reg = "/mt-pmic/buck_regulators/buck_vcore";
		mt_pmic_vproc_buck_reg = "/mt-pmic/buck_regulators/buck_vproc";
		mt_pmic_vpa_buck_reg = "/mt-pmic/buck_regulators/buck_vpa";
		mt_pmic_vfe28_ldo_reg = "/mt-pmic/ldo_regulators/ldo_vfe28";
		mt_pmic_vxo22_ldo_reg = "/mt-pmic/ldo_regulators/ldo_vxo22";
		mt_pmic_vrf18_ldo_reg = "/mt-pmic/ldo_regulators/ldo_vrf18";
		mt_pmic_vrf12_ldo_reg = "/mt-pmic/ldo_regulators/ldo_vrf12";
		mt_pmic_vefuse_ldo_reg = "/mt-pmic/ldo_regulators/ldo_vefuse";
		mt_pmic_vcn33_bt_ldo_reg = "/mt-pmic/ldo_regulators/ldo_vcn33_bt";
		mt_pmic_vcn33_wifi_ldo_reg = "/mt-pmic/ldo_regulators/ldo_vcn33_wifi";
		mt_pmic_vcn28_ldo_reg = "/mt-pmic/ldo_regulators/ldo_vcn28";
		mt_pmic_vcn18_ldo_reg = "/mt-pmic/ldo_regulators/ldo_vcn18";
		mt_pmic_vcama_ldo_reg = "/mt-pmic/ldo_regulators/ldo_vcama";
		mt_pmic_vcamd_ldo_reg = "/mt-pmic/ldo_regulators/ldo_vcamd";
		mt_pmic_vcamio_ldo_reg = "/mt-pmic/ldo_regulators/ldo_vcamio";
		mt_pmic_vldo28_ldo_reg = "/mt-pmic/ldo_regulators/ldo_vldo28";
		mt_pmic_vsram_others_ldo_reg = "/mt-pmic/ldo_regulators/ldo_vsram_others";
		mt_pmic_vsram_proc_ldo_reg = "/mt-pmic/ldo_regulators/ldo_vsram_proc";
		mt_pmic_vaux18_ldo_reg = "/mt-pmic/ldo_regulators/ldo_vaux18";
		mt_pmic_vaud28_ldo_reg = "/mt-pmic/ldo_regulators/ldo_vaud28";
		mt_pmic_vio28_ldo_reg = "/mt-pmic/ldo_regulators/ldo_vio28";
		mt_pmic_vio18_ldo_reg = "/mt-pmic/ldo_regulators/ldo_vio18";
		mt_pmic_vdram_ldo_reg = "/mt-pmic/ldo_regulators/ldo_vdram";
		mt_pmic_vmc_ldo_reg = "/mt-pmic/ldo_regulators/ldo_vmc";
		mt_pmic_vmch_ldo_reg = "/mt-pmic/ldo_regulators/ldo_vmch";
		mt_pmic_vemc_ldo_reg = "/mt-pmic/ldo_regulators/ldo_vemc";
		mt_pmic_vsim1_ldo_reg = "/mt-pmic/ldo_regulators/ldo_vsim1";
		mt_pmic_vsim2_ldo_reg = "/mt-pmic/ldo_regulators/ldo_vsim2";
		mt_pmic_vibr_ldo_reg = "/mt-pmic/ldo_regulators/ldo_vibr";
		mt_pmic_vusb33_ldo_reg = "/mt-pmic/ldo_regulators/ldo_vusb33";
		keypad = "/kp@10010000";
		mrdump_ext_rst = "/mrdump_ext_rst";
		touch = "/touch";
		accdet = "/accdet";
		bat_gm30 = "/battery";
		iommu = "/m4u@10205000";
		mdcldma = "/mdcldma@10014000";
		gce = "/gce@10238000";
		gce_mbox = "/gce_mbox@10238000";
		auxadc = "/auxadc@11001000";
		apdma = "/dma-controller@11000580";
		uart0 = "/serial@11020000";
		uart1 = "/serial@11030000";
		pwm = "/pwm@11006000";
		i2c_common = "/i2c_common";
		i2c0 = "/i2c0@11007000";
		i2c1 = "/i2c1@11008000";
		i2c2 = "/i2c2@11009000";
		i2c3 = "/i2c3@1100f000";
		i2c4 = "/i2c4@11011000";
		i2c5 = "/i2c5@11016000";
		i2c6 = "/i2c6@1100d000";
		i2c7 = "/i2c7";
		i2c8 = "/i2c8";
		i2c9 = "/i2c9";
		spi0 = "/spi0@1100a000";
		consys = "/consys@18002000";
		spi1 = "/spi1@11010000";
		spi2 = "/spi2@11012000";
		spi3 = "/spi3@11013000";
		spi4 = "/spi4@11014000";
		spi5 = "/spi5@11015000";
		msdc0 = "/msdc@11230000";
		msdc1 = "/msdc@11240000";
		msdc2 = "/msdc@11250000";
		msdc3 = "/msdc@11260000";
		msdc1_ins = "/msdc1_ins@0";
		audio = "/audio@11220000";
		audgpio = "/mt_soc_dl1_pcm@11220000";
		mipi_rx_ana_csi0a = "/mipi_rx_ana_csi0a@11c10000";
		mipi_rx_ana_csi0b = "/mipi_rx_ana_csi0b@11c11000";
		mipi_rx_ana_csi1a = "/mipi_rx_ana_csi1a@11c12000";
		mipi_rx_ana_csi1b = "/mipi_rx_ana_csi1b@11c13000";
		mipi_rx_ana_csi2a = "/mipi_rx_ana_csi2a@11c14000";
		mipi_rx_ana_csi2b = "/mipi_rx_ana_csi2b@11c15000";
		mfg_cfg = "/mfg_cfg@13ffe000";
		mmsys_config = "/mmsys_config@14000000";
		nfc = "/nfc";
		irq_nfc = "/irq_nfc";
		disp_mutex0 = "/disp_mutex0@14001000";
		smi_larb0 = "/smi_larb0@14003000";
		mdp_rdma0 = "/mdp_rdma0@14004000";
		mdp_ccorr = "/mdp_ccorr0@14005000";
		mdp_rsz0 = "/mdp_rsz0@14006000";
		mdp_rsz1 = "/mdp_rsz1@14007000";
		mdp_wdma0 = "/mdp_wdma0@14008000";
		mdp_wrot0 = "/mdp_wrot0@14009000";
		mdp_tdshp0 = "/mdp_tdshp0@1400a000";
		disp_color0 = "/disp_color0@1400f000";
		mtkfb = "/mtkfb@0";
		dsi_te = "/dsi_te";
		mm_mutex = "/mm_mutex@14016000";
		camsys = "/camsys@15000000";
		smi_larb2 = "/smi_larb2@15001000";
		kd_camera_hw1 = "/kd_camera_hw1@15040000";
		flashlight_core = "/flashlight_core";
		flashlights_mt6370 = "/flashlights_mt6370";
		flashlights_aw3644 = "/flashlights_aw3644";
		venc_gcon = "/venc_gcon@17000000";
		smi_larb1 = "/smi_larb1@17010000";
		otg_iddig = "/otg_iddig";
		odm = "/odm";
		radio_md_cfg = "/radio_md_cfg";
		dynamic_options = "/dynamic_options";
		mt_charger = "/mt_charger";
		lk_charger = "/lk_charger";
		charger = "/charger";
		pmic_clock_buffer_ctrl = "/pmic_clock_buffer_ctrl";
		mt6370_pmu = "/mt6370_pmu_dts";
		mt6370_typec = "/type_c_port0";
	};
};
