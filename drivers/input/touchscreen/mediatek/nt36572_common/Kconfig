## drivers/input/touchscreen/mediatek/nt36572_common/Kconfig
```kconfig
#
# Novatek NT36572_COMMON touchscreen driver configuration
#
if TOUCHSCREEN_MTK_NT36572_COMMON

config TOUCHSCREEN_NT36572_COMMON
	bool "Novatek NT36572_COMMON"
	default y
	help
	  Say Y here if you have a Novatek NT36572_COMMON touchscreen connected
	  to your system.

	  If unsure, say N.

endif
```
